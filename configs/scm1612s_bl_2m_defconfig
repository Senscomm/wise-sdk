## hal/arch/ndsv5/Kconfig
```kconfig
menu "NDSV5 architecture"
	depends on NDSV5

config SYS_ARCH
	default "ndsv5"

config TOOLCHAIN_PATH
	string "Cross toolchain path"
	default "/opt/nds32le-elf-mculib-v5/bin/"

config MARCH_OPTION
	string "-march option"
	default "rv32imac"

config MABI_OPTION
	string "-mabi option"
	default "ilp32"

config NR_IRQ
	int "number of interrupt lines"
	default 49

config NR_SW_IRQ
	int "number of SW interrupt lines"
	default 2

config DEVICE_REGION
	bool "Device region defined"
	default y

config CACHE_LINE
	int "(I/D)-Cache line size"
	default 32

config HW_PRIO_SUPPORT
	bool "Support prioritized interrupt"
	default n

config IRQ_STACK_SIZE
	int "interrupt stack size (bytes)"
	default 2048

config ICACHE_ENABLE
	bool "Instruction cache"
	default y

config DCACHE_ENABLE
	bool "Data cache"
	default n

config SUPPORT_EXECIT
	bool "Support EXEC.IT optimization"
	default n
	help
	 Say y if you want to support Executaion on Instruction Table Optimization. It will replace 32-bit instruction by the 16-bit instruction when it appears more than 3 times.

config OPTIM_OPTION
	string "GCC optimization option"
	default "-Os -g3"

config CORE_DUMP
    bool "Enable core dump"
    default y

config FRAME_POINTER
	bool "Compile the Wise with frame pointers"
	default n
	---help---
		If you say Y here the resulting Wise image will be slightly
		larger and slower, but it gives very useful debugging information
		in case of bugs.

endmenu
```

## hal/board/Kconfig
```kconfig
choice
    prompt "Target board/platform"
    default BOARD_SCM2010_EVB_QFN40

config BOARD_SCM2010_EVB_QFN40
    bool "SCM2010 EVB for QFN40 package"
    select SOC_SCM2010
    select PINCTRL if !BOOTROM
    select PINCTRL_SCM2010 if !BOOTROM

config BOARD_SCM2010_MODULE_1212A
    bool "SCM2010 12*12 Module (type A)"
    select SOC_SCM2010
    select PINCTRL if !BOOTROM
    select PINCTRL_SCM2010 if !BOOTROM

config BOARD_SCM2010_MODULE_1212G
    bool "SCM2010 12*12 Module (type G)"
    select SOC_SCM2010
    select SDIO_OOB_GPIO_INT
    select PINCTRL if !BOOTROM
    select PINCTRL_SCM2010 if !BOOTROM

config BOARD_SCM2010_MODULE_1614H
    bool "SCM2010 16*14 Module (type H)"
    select SOC_SCM2010
    select PINCTRL if !BOOTROM
    select PINCTRL_SCM2010 if !BOOTROM
    select USE_I2C1
    select USE_I2S
    select API_I2C
    select AUDIO
    select ES8311
    select API_AUDIO
    select CLI_AUDIO
    select I2S
    select API_I2S
    select CLI_I2S

config BOARD_SCM2010_EVB_QFN32
    bool "SCM2010 EVB for QFN32 package"
    select SOC_SCM2010
    select HOSTBOOT
    select PINCTRL if !BOOTROM
    select PINCTRL_SCM2010 if !BOOTROM

config BOARD_C1T301A34
    bool "C1T301A34"
    select SOC_SCM2010
    select PINCTRL if !BOOTROM
    select PINCTRL_SCM2010 if !BOOTROM
    select USE_I2C1
    select USE_SPI2
    select USE_SPI2_FLASH
    select SPI_FLASH_PUYA
    select USE_I2S
    select CMD_UTIL_FILE
    select CLI_FS
    select API_I2C
    select AUDIO
    select ES8311
    select ES8311_I2C_ADDR_HI
    select API_AUDIO
    select CLI_AUDIO
    select I2S
    select API_I2S
    select CLI_I2S

endchoice

source "hal/board/scm2010-evb-qfn40/Kconfig"
source "hal/board/scm2010-evb-qfn32/Kconfig"
source "hal/board/scm2010-mod-1212a/Kconfig"
source "hal/board/scm2010-mod-1212g/Kconfig"
source "hal/board/scm2010-mod-1614h/Kconfig"
source "hal/board/c1t301a34/Kconfig"
```

## hal/board/c1t301a34/Kconfig
```kconfig
if BOARD_C1T301A34

config SYS_BOARD
	default "c1t301a34"

config SERIAL_CONSOLE_PORT
	default 1

endif
```

## hal/board/scm2010-evb-qfn32/Kconfig
```kconfig
if BOARD_SCM2010_EVB_QFN32

config SYS_BOARD
	default "scm2010-evb-qfn32"

config SERIAL_CONSOLE_PORT
	default 1

endif
```

## hal/board/scm2010-evb-qfn40/Kconfig
```kconfig
if BOARD_SCM2010_EVB_QFN40

config SYS_BOARD
	default "scm2010-evb-qfn40"

config SERIAL_CONSOLE_PORT
	default 1

endif
```

## hal/board/scm2010-mod-1212a/Kconfig
```kconfig
if BOARD_SCM2010_MODULE_1212A

config SYS_BOARD
	default "scm2010-mod-1212a"

config SERIAL_CONSOLE_PORT
	default 0

endif
```

## hal/board/scm2010-mod-1212g/Kconfig
```kconfig
if BOARD_SCM2010_MODULE_1212G

config SYS_BOARD
	default "scm2010-mod-1212g"

config SERIAL_CONSOLE_PORT
	default 1

endif
```

## hal/board/scm2010-mod-1614h/Kconfig
```kconfig
if BOARD_SCM2010_MODULE_1614H

config SYS_BOARD
	default "scm2010-mod-1614h"

config SERIAL_CONSOLE_PORT
	default 1

endif
```

## hal/drivers/Kconfig
```kconfig
menu "Device drivers"

config HAL_ASSERT_VERBOSITY
	int "assert() verbosity"
	default 2

source "hal/drivers/core/Kconfig"

source "hal/drivers/clk/Kconfig"

source "hal/drivers/pinctrl/Kconfig"

source "hal/drivers/serial/Kconfig"

source "hal/drivers/timer/Kconfig"

source "hal/drivers/spi-flash/Kconfig"

source "hal/drivers/wlan/Kconfig"

source "hal/drivers/rf/Kconfig"

source "hal/drivers/rtc/Kconfig"

source "hal/drivers/watchdog/Kconfig"

source "hal/drivers/crypto/Kconfig"

source "hal/drivers/efuse/Kconfig"

source "hal/drivers/sdio/Kconfig"

source "hal/drivers/dma/Kconfig"

source "hal/drivers/systimer/Kconfig"

source "hal/drivers/pta/Kconfig"

source "hal/drivers/i2c/Kconfig"

source "hal/drivers/spi/Kconfig"

source "hal/drivers/adc/Kconfig"

source "hal/drivers/i2s/Kconfig"

source "hal/drivers/audio/Kconfig"

endmenu
```

## hal/drivers/adc/Kconfig
```kconfig
menu "ADC Support"

config ADC
	bool "Enable ADC driver framework"
    default n
	depends on USE_AUXADC
	help
      Enable ADC driver framework.

if ADC

config ADC_XRCADC
	bool "XRC ADC support"
	default y if SOC_SCM2010

endif

endmenu
```

## hal/drivers/audio/Kconfig
```kconfig
menu "Audio CODEC Support"

config AUDIO
	bool "Enable Audio CODEC driver framework"
    default n
	depends on I2S && I2C
	help
      Enable Audio CODEC driver framework.

if AUDIO

choice
    prompt "Select CODEC"
    default ES8311

config TLV320AIC3110
	bool "TLV320AIC3110"

config ES8311
	bool "ES8311"

endchoice

if TLV320AIC3110

choice
    prompt "Select PLL_CLKIN"
	default PLLCLKIN_GPIO1

config PLLCLKIN_MCLK
	bool "Select MCLK as PLL_CLKIN"

config PLLCLKIN_GPIO1
	bool "Select GPIO1 as PLL_CLKIN"

endchoice

endif

if ES8311

config ES8311_I2C_ADDR_HI
    bool "High I2C slave address (7-bit, 0x19)"
    default n

choice
    prompt "Select output mode"
	default ES8311_OUT_DRV_LINE

config ES8311_OUT_DRV_LINE
	bool "Enable line out driver"

config ES8311_OUT_DRV_HP
	bool "Enable HP driver"

endchoice

endif


config AUDIO_CLI
    bool
	depends on CMDLINE
    default n

endif

endmenu
```

## hal/drivers/core/Kconfig
```kconfig
menu "Generic Driver Options"

config PM_DM
	bool "Enable Driver Model for PM"
	help
	  This config option enables pm_suspend_device and pm_resume_device.

endmenu
```

## hal/drivers/crypto/Kconfig
```kconfig
menu "HW crypto Support"

config HW_CRYPTO
	bool "Enable hw crypto engine"
	help
	  Enable driver model for crypto hw. 

endmenu
```

## hal/drivers/dma/Kconfig
```kconfig
menu "DMA Support"

config DMA
	bool "Enable DMA driver framework"
    default n
    help
      Enable DMA driver framework.

if DMA

config DMA_SCM2010
	bool "Senscomm SCM2010 DMA support"
	default y

config IPC_DMA
	bool "Enable DMA Channel of IPC"
	depends on IPC
	default y

if DMA_SCM2010

config SCM2010_DMAC_NUM
	int "support 2 scm2010 DMAC"
	default 2

config SCM2010_DMA0_CH_NUM
	int "Number of channels in DMA0"
	default 4

config SCM2010_DMA_DESC_NUM
	int "default support 4 dma descriptors per channel"
	default 4
endif

endif

endmenu
```

## hal/drivers/efuse/Kconfig
```kconfig
menu "eFuse Support"

config EFUSE
	bool "Enable eFuse driver"
	help
	  Enable driver model for eFuse HW. 

if EFUSE

config EFUSE_SCM2010
	bool "Senscomm SCM2010 eFuse support"
	default y

config EFUSE_NUM_ROW
	int "Number of 32-bit rows"
	default 32

config EFUSE_BUFFER_MODE
	bool "Enable eFuse buffer mode(RAM, FLASH)"
	default n

if EFUSE_BUFFER_MODE

config EFUSE_FLASH_BUFFER_ADDR
    hex "Buffer address in serial flash"
    default 0x80013000

endif

endif


endmenu
```

## hal/drivers/i2c/Kconfig
```kconfig
menu "I2C Support"

config I2C
	bool "Enable I2C driver framework"
    default n
	depends on USE_I2C0 || USE_I2C1 || USE_I2C_GPIO
	help
      Enable I2C driver framework.

if I2C

config I2C_ATCI2C
	bool "AndesTech AndeShape ATCIIC support"
	default y if SOC_SCM2010
	depends on USE_I2C0 || USE_I2C1

config I2C_GPIO
	bool "I2C GPIO bit-bang support"
	default y
	depends on USE_I2C_GPIO

endif

endmenu
```

## hal/drivers/i2s/Kconfig
```kconfig
menu "I2S Support"

config I2S
	bool "Enable I2S driver framework"
    default n
	depends on USE_I2S
	help
      Enable I2S driver framework.

if I2S

config I2S_PYTHON
	bool "Python I2S support"
	default y if SOC_SCM2010
	select DMA

if I2S_PYTHON

config I2S_PYTHON_RX_BLOCK_COUNT
	int "Size of Rx queue"
	default 32

config I2S_PYTHON_TX_BLOCK_COUNT
	int "Size of Tx queue"
	default 32

endif

endif

endmenu
```

## hal/drivers/pinctrl/Kconfig
```kconfig
#
# PINCTRL infrastructure and drivers
#

menu "Pin controllers"

config PINCTRL
	bool "Support pin controllers"
	help
	  This enables the basic support for pinctrl framework.  You may want
	  to enable some more options depending on what you want to do.

if PINCTRL

choice
	prompt "Pinctrl select"
	default y

config PINCTRL_TS8266
	bool "TS8266 pin control driver"

config PINCTRL_SCM1010
	bool "SCM1010 pin control driver"

config PINCTRL_BCM2836
	bool "BCM2836 pin control driver"

config PINCTRL_SCM2010
	bool "SCM2010 pin control driver"

endchoice

if PINCTRL_SCM2010

config SCM2010_PINCTRL_INT_WORKAROUND
	bool "SCM2010 pin interrupt work-around"
	default y

if SCM2010_PINCTRL_INT_WORKAROUND

config SCM2010_PINCTRL_INT_WA_PERIOD
	int  "SCM2010 pin interrupt work-around period in ms"
	default 1000

config SCM2010_PINCTRL_INT_WA_DURATION
	int  "SCM2010 pin interrupt work-around duration in ms"
	default 10000

endif

config SCM2010_PINIO_PM_CTRL
	bool "SCM2010 pin io power management control"
	default n

endif

endif

endmenu
```

## hal/drivers/pta/Kconfig
```kconfig
menu "PTA Support"

config PTA
	bool "Enable PTA driver framework"
    default y
	help
	  Packet Transmit Arbiter for WLAN and BLE

if PTA

config PTA_SCM2010

	bool "SCM2010 PTA support"
	default y

endif

endmenu
```

## hal/drivers/rf/Kconfig
```kconfig
menu "RF Support"

config RF
	bool "Enable rf driver framework"
	help
	  Enable driver model for rf. 

if RF

config RF_MANGO
	bool "Mango RF support"
	depends on SYS_FPGA
	default y

config RF_XRC564
	bool "XRC564 RF support"
	depends on SOC_SCM2010 && !SYS_FPGA
	default y

config RF_CLI
	bool "RF CLI support"
	default n

endif

endmenu
```

## hal/drivers/rtc/Kconfig
```kconfig
menu "Real Time Clock Support"

config RTC
	bool "Enable rtc driver framework"
	help
	  Enable driver model for rtc.

if RTC

config RTC_ATCRTC
	bool "AndesTech AndeShape ATCRTC support" if RTC
	default y

config ATCRTC_SCM2010
	bool "ATCRTC modified SCM2010" if RTC_ATCRTC
	default y

config SUPPORT_RTC_ALARM_INT
	bool "SCM2010 Alarm interrupt support" if RTC_ATCRTC
	default y

config SUPPORT_EXT_RTC
   bool "Use EXT-RTC as RTC source"
   default n

choice
    prompt "Select RTC Implementation"
    depends on SUPPORT_EXT_RTC
    default SD3068

config SD3068
    bool "SD3068 RTC"

config PCF8563LX
    bool "PCF8563LX RTC"

endchoice

endif

endmenu
```

## hal/drivers/sdio/Kconfig
```kconfig
menu "SDIO Support"

config SDIO
    bool "Enable sdio driver"
    default n
    help
        Enable sdio driver.

if SDIO

config SDIO_USE_IRQD
	bool "Use irq_dispatcher"
	default n

if SDIO_USE_IRQD

config USE_SYSDMA_FOR_IRQD_DN
	bool "Use DMA engine for IRQD loading"
	default y

endif

config SDIO_VERIFICATION_TEST
	bool "Enable sdio verification test"
	select SCDC_DATA_TEST
	default n

config SDIO_MAX_TRAN_SPEED
    int "SDIO maximum transfer speed"
    default 15000000 if SYS_FPGA
    default 50000000 if !SYS_FPGA

config SDIO_RCV_BUFFER_SIZE
    int "SDIO recv buffer size"
    default 20480

config SDIO_FIFO_MIN_LINEAR_SIZE
    int "SDIO FIFO min linear size"
    default 1700

config SDIO_RECOVERY
    bool "Enable SDIO auto recovery from FIFO read/write index mismatch"
    default y

config SDIO_1BIT_MODE
    bool "Use 1-bit data transfer mode"
    default n

config SDIO_TXCHAIN
    bool "Use TX chain data transfer mode"
    default y

config SDIO_OOB_GPIO_INT
    bool "Use OOB gpio to trigger interrupt to Host"
    default n

if SDIO_OOB_GPIO_INT

config SDIO_OOB_GPIO_INT_PIN
    int "SDIO OOB interrupt pin"
    default 21

endif

config SDIO_PM
    bool "Enable SDIO PM"
    depends on PM_SCM2010
    default n

if SDIO_PM
config SDIO_NOTIFY_REENUM_GPIO
    int "GPIO notify host to reenum"
    default 7

config SDIO_WAKEUP_HOLD_TIME_MS
    int "The duration (in milliseconds) to keep the system awake"
    default 3

endif

endif

endmenu
```

## hal/drivers/serial/Kconfig
```kconfig
#
# Serial device configuration
#

menuconfig SERIAL
	bool "Serial drivers"
	help

if SERIAL

config BAUDRATE
	int "Default baudrate"
	default 115200
	help
	  Select a default baudrate, where "default" has a driver-specific
	  meaning of either setting the baudrate for the early debug UART
	  in the SPL stage (most drivers) or for choosing a default baudrate
	  in the absence of an environment setting (serial_mxc.c).

config SERIAL_BUFFER_SIZE
	int "Software FIFO size"
	default 256
	help
	  The size of the software FIFO

config SERIAL_CONSOLE
	bool "Serial console"
	depends on SERIAL
	default y
	help
	  Say Y to enable serial console

config SERIAL_CONSOLE_PORT
	int "Console serial port #"
	depends on SERIAL_CONSOLE
	default 0
	help
	  Configures the serial port index used as console.

config FREERTOS_SERIAL_API
       bool "FreeRTOS serial API support (not recommended)"
       default n
       help
        Say Y to enable FreeRTOS serial API such as xSerialPortInit() and PutChar().
	WISE does not recommend use of these APIs.

config SERIAL_SCM2020
	bool "Senscomm SCM2020 UART support"

config SERIAL_PL011
	bool "Arm Primecell PL011 UART support"

config SERIAL_ATCUART
	bool "AndesTech AndeShape ATCUART support"
	default y
	depends on USE_UART0 || USE_UART1 || USE_UART2

config SERIAL_SANDBOX
	bool "Sandbox virtual UART support"

endif
```
