## lib/lwip/Kconfig.inet6
```kconfig
menuconfig LWIP_IPV6
 	bool "IPv6 support"
	default n

if LWIP_IPV6
config IPV6_REASS_MAXAGE
	int "IPv6: max time (in multiples of IP6_REASS_TMR_INTERVAL)"
	default 60
	help
	 Maximum time (in multiples of IP6_REASS_TMR_INTERVAL - so seconds, normally)
 	 a fragmented IP packet waits for all fragments to arrive. If not all fragments arrived
 	 in this time, the whole packet is discarded.

config LWIP_IPV6_SCOPES
 	bool "IPv6: enable IPv6 address scopes (?)"
	default (LWIP_IPV6 && !LWIP_SINGLE_NETIF)
	help
 	 Enable support for IPv6 address scopes, ensuring that
 	 e.g. link-local addresses are really treated as link-local. Disable this
 	 setting only for single-interface configurations.

config LWIP_IPV6_SCOPES_DEBUG
	bool "IPv6: enable IPv6 scope debugging"
	default n
	help
 	 Perform run-time checks to verify that addresses
 	 are properly zoned (see ip6_zone.h on what that means) where it matters.
 	 Enabling this setting is highly recommended when upgrading from an existing
 	 installation that is not yet scope-aware; otherwise it may be too expensive.

config LWIP_IPV6_NUM_ADDRESSES
	int "IPv6: number of IPv6 addresses per netif"
	default 3

config LWIP_IPV6_FORWARD
 	bool "IPv6: IPv6 packet forwarding"
	default n

config LWIP_IPV6_FRAG
 	bool "IPv6: fragmentation"
	default LWIP_IPV6

config LWIP_IPV6_REASS
	bool "IPv6: reassembly"
	default LWIP_IPV6

config LWIP_IPV6_SEND_ROUTER_SOLICIT
	bool "IPv6: router solicitation during network startup"
	default y

config LWIP_IPV6_AUTOCONFIG
 	bool "IPv6: stateless address autoconfiguration as per RFC 4862"
	default LWIP_IPV6

config LWIP_IPV6_ADDRESS_LIFETIMES
	bool "IPv6: keep valid and preferred lifetimes for each IPv6 address"
	default LWIP_IPV6_AUTOCONFIG
	help
	 Required for LWIP_IPV6_AUTOCONFIG. May still be enabled
 	 otherwise, in which case the application may assign address lifetimes with
 	 the appropriate macros. Addresses with no lifetime are assumed to be static.
 	 If this option is disabled, all addresses are assumed to be static.

config LWIP_IPV6_DUP_DETECT_ATTEMPTS
	int "IPv6: number of duplicate address detection attempts"
	default 1

config LWIP_ICMP6
 	bool "IPv6: ICMPv6 support (mandatory per RFC)"
	default y

config LWIP_ICMP6_DATASIZE
	int "IPv6: number of bytes from original packet in ICMPv6 error messages"
	default 8

config LWIP_ICMP6_HL
	int "IPv6: hop limit for ICMPv6 messages"
	default 255

config ICMP6_CHECKSUM_OFFLOADING
       bool "ICMP6: checksum offloading"
       default n

config CHECKSUM_GEN_ICMP6
	bool
	default !ICMP6_CHECKSUM_OFFLOADING

config CHECKSUM_CHECK_ICMP6
	bool
	default !ICMP6_CHECKSUM_OFFLOADING

config LWIP_IPV6_MLD
 	bool "IPv6: multicast listener discovery protocol"
	default n
	help
 	 If LWIP_IPV6 is enabled but this setting is disabled, the MAC layer must
 	 indiscriminately pass all inbound IPv6 multicast traffic to lwIP.

config MEMP_NUM_MLD6_GROUP
	int "IPv6: max number of IPv6 multicast groups that can be joined"
	default 4
	help
 	 There must be enough groups so that each netif can join the solicited-node
 	 multicast group for each of its local addresses, plus one for MDNS if
 	 applicable, plus any number of groups to be joined on UDP sockets.

config LWIP_ND6_QUEUEING
 	bool "IPv6: queue outgoing packets while MAC address is being resolved"
	default y

config MEMP_NUM_ND6_QUEUE
	int "IPv6: max number of IPv6 packets to queue during MAC resolution"
	default 20

config LWIP_ND6_NUM_NEIGHBORS
	int "IPv6: number of entries in IPv6 neighbor cache"
	default 10

config LWIP_ND6_NUM_DESTINATIONS
	int "IPv6: number of entries in IPv6 destination cache"
	default 10

config LWIP_ND6_NUM_PREFIXES
	int "IPv6: number of entries in IPv6 on-link prefixes cache"
	default 5

config LWIP_ND6_NUM_ROUTERS
	int "IPv6: number of entries in IPv6 default router cache"
	default 3

config LWIP_ND6_MAX_MULTICAST_SOLICIT
	int "IPv6: max number of multicast neighbor/router solicit messages to send"
	default 3

config LWIP_ND6_MAX_UNICAST_SOLICIT
	int "IPv6: max number of unicast neighbor solicitation messages to send"
	default 3
	help
	 During neighbor reachability detection.

config LWIP_ND6_REACHABLE_TIME
	int "IPv6: neighbor reachable time (in milliseconds)"
	default 3000
	help
 	 May be updated by router advertisement messages.

config LWIP_ND6_RETRANS_TIMER
	int "IPv6: default retransmission timer for solicitation messages"
	default 1000

config LWIP_ND6_DELAY_FIRST_PROBE_TIME
	int "IPv6: delay before first unicast neighbor solicitation"
	default 5000
	help
	 Delay before first unicast neighbor solicitation"
 	 message is sent, during neighbor reachability detection.

config LWIP_ND6_ALLOW_RA_UPDATES
	bool "IPv6: Router Advertisement update"
	default y
	help
 	 Allow Router Advertisement messages to update
 	 Reachable time and retransmission timers, and netif MTU.

config LWIP_ND6_TCP_REACHABILITY_HINTS
	bool "IPv6: allow TCP to provide Neighbor Discovery"
	default y
	help
 	 Allow TCP to provide Neighbor Discovery
 	 with reachability hints for connected destinations. This helps avoid sending
 	 unicast neighbor solicitation messages.

config LWIP_ND6_RDNSS_MAX_DNS_SERVERS
	bool "IPv6: use IPv6 Router Advertisement Recursive DNS Server option"
	default n
	help
	 Use IPv6 Router Advertisement Recursive
 	 DNS Server Option (as per RFC 6106) to copy a defined maximum number of DNS
 	 servers to the DNS module.

config LWIP_IPV6_DHCP6
 	bool "IPv6: DHCPv6 stateful address autoconfiguration"
	default LWIP_IPV6

endif # LWIP_IPV6
```

## lib/lwip/Kconfig.mem
```kconfig
menu "Memory management options"

config MEM_LIBC_MALLOC
       bool "Use stdlib malloc/free/realloc"
       default y
       help
        Use malloc/free/realloc provided by your C-library
	instead of the lwip internal allocator. Can save code size if you
	already use it.

config MEMP_MEM_MALLOC
       bool "Use mem_malloc/mem_free as pool allocator"
       default n
       help
        Use mem_malloc/mem_free instead of the lwip pool allocator.
	Especially useful with MEM_LIBC_MALLOC but handle with care regarding execution
	speed (heap alloc can be much slower than pool alloc) and usage from interrupts
	(especially if your netif driver allocates PBUF_POOL pbufs for received frames
	from interrupt)!
	ATTENTION: Currently, this uses the heap for ALL pools (also for private pools,
	not only for internal pools defined in memp_std.h)! This means you cannot designate
	memory sections for particular pool.

config MEMP_MEM_INIT
       bool "Zero initialize memory pool"
       default y
       help
        Force use of memset to initialize pool memory.
	Useful if pool are moved in uninitialized section of memory. This will ensure
	default values in pcbs struct are well initialized in all conditions.

config MEM_ALIGNMENT
       int "Memory alignment"
       default 4

config MEM_MEMP_DEFAULT_SECTION
       string "Memory pool default section"
       default ".bss"
       help
        Specify a default section in which statically allocated memory pools are
        placed.

# Not used
#config MEM_SIZE
#      int
#      default HEAP_SIZE

config MEMP_STATS_LOCAL
       bool "Enable Memory pool statistics"
	   default n
	   select MEMP_STATS
	   select LWIP_STATS
	   depends on !LWIP

config MEMP_OVERFLOW_CHECK
       int "Check Memory pool overflow"
       default 0
       help
        memp overflow protection reserves a configurable
	amount of bytes before and after each memp element in every pool and fills
	it with a prominent default value.
	MEMP_OVERFLOW_CHECK == 0 no checking
	MEMP_OVERFLOW_CHECK == 1 checks each element when it is freed
	MEMP_OVERFLOW_CHECK >= 2 checks each element in every pool every time memp_malloc() or memp_free() is called (useful but slow!)

config MEMP_OWNER_CHECK
       bool "Check Memory pool users"
       default n
       help
        Added to help detect memp leaks


config MEMP_SANITY_CHECK
	bool "Check memory pool sanity"
	default n
	help
	 run a sanity check after each memp_free() to make sure that there are no cycles in the linked lists.

config MEM_SANITY_CHECK
	bool "Check memory sanity"
	default n
	help
	 run a sanity check after each mem_free() to make
	 sure that the linked list of heap elements is not corrupted.

config MEM_USE_POOLS
	bool "Use memory pool allocator"
	default n
	help
	 Use an alternative to malloc() by allocating from a set
	 of memory pools of various sizes. When mem_malloc is called, an element of
	 the smallest pool that can provide the length needed is returned.
	 To use this, MEMP_USE_CUSTOM_POOLS also has to be enabled.

config MEM_USE_POOLS_TRY_BIGGER_POOL
	bool "Try larger pool if malloc-pool fails"
	default n

config MEMP_USE_CUSTOM_POOLS
	bool "Add user-defined pools"
	default FREEBSD
	help
	 whether to include a user file lwippools.h
	 that defines additional pools beyond the "standard" ones required
	 by lwIP. If you set this to 1, you must have lwippools.h in your
	 include path somewhere.

config LWIP_ALLOW_MEM_FREE_FROM_OTHER_CONTEXT
       bool "Allow mem_free() to be called other than tcp thread"
       default 0
       help
        Set this to 1 if you want to free PBUF_RAM pbufs (or call mem_free()) from
	interrupt context (or another context that doesn't allow waiting for a
	semaphore).
	If set to 1, mem_malloc will be protected by a semaphore and SYS_ARCH_PROTECT,
	while mem_free will only use SYS_ARCH_PROTECT. mem_malloc SYS_ARCH_UNPROTECTs
	with each loop so that mem_free can run.
	ATTENTION: As you can see from the above description, this leads to dis-/
	enabling interrupts often, which can be slow! Also, on low memory, mem_malloc
	can need longer.
	If you don't want that, at least for NO_SYS=0, you can still use the following
	functions to enqueue a deallocation call which then runs in the tcpip_thread
	context:
	- pbuf_free_callback(p);
	- mem_free_callback(m);

comment "Memory pool size"

config MEMP_NUM_PBUF
       int "# of memp struct pbufs (used for PBUF_ROM and PBUF_REF)"
       default 0
       help
        The number of memp struct pbufs (used for PBUF_ROM and PBUF_REF).
	If the application sends a lot of data out of ROM (or other static memory),
	this should be set high.

config MEMP_NUM_RAW_PCB
	depends on LWIP_RAW
	int "# of RAW PCBs"
	default 0

config MEMP_NUM_UDP_PCB
	depends on LWIP_UDP
	int "# of UDP PCBs"
	default 0

config MEMP_NUM_TCP_PCB
	depends on LWIP_TCP
	int "# of TCP PCBs"
	default 0

config MEMP_NUM_TCP_PCB_LISTEN
	int "# of listening TCP connections"
	depends on LWIP_TCP
	default 0

config MEMP_NUM_TCP_SEG
	int "# of simultaneously queued TCP segments"
	depends on LWIP_TCP
	default 0

config MEMP_NUM_ALTCP_PCB
	int "# of simultaneously active altcp layer pcbs"
	depends on LWIP_ALTTCP
	default MEMP_NUM_TCP_PCB

config MEMP_NUM_REASSDATA
	int "# of IP packets (not fragments) simultaneously queued for reassembly"
	default 0

config MEMP_NUM_FRAG_PBUF
	int "# of IP fragments simultaneously sent"
	default 0
	depends on !LWIP_NETIF_TX_SINGLE_PBUF

config MEMP_NUM_ARP_QUEUE
	int "# of outgoing packets waiting for address resolution"
	default 0
	depends on ARP_QUEUEING

config MEMP_NUM_IGMP_GROUP
	int "# of multicast groups"
	default 0
	depends on LWIP_IGMP
	help
	 # of multicast groups whose network interfaces
	 can be members at the same time (one per netif - allsystems group -, plus one
	 per netif membership).

config MEMP_NUM_NETBUF
	int "# of struct netbufs"
	default 0
	depends on LWIP_NETCONN || (LWIP_SOCKET || WISE_SOCKET)

#lwipopt.h
#config MEMP_NUM_NETCONN
#	int "# of struct netconns"
#	default 0

config MEMP_NUM_SELECT_CB
	int "# of struct lwip_select_cb"
	default 0
    depends on (LWIP_SOCKET || WISE_SOCKET) && (LWIP_SOCKET_SELECT || LWIP_SOCKET_POLL)


config MEMP_NUM_TCPIP_MSG_API
	int "# of struct tcpip_msg"
	default 0

config MEMP_NUM_TCPIP_MSG_INPKT
	int "# of struct tcpip_msg for incoming packets"
	default 0
    depends on !LWIP_TCPIP_CORE_LOCKING_INPUT

config MEMP_NUM_NETDB
	int "# of concurrently running lwip_addrinfo() calls"
	default 0

config MEMP_NUM_LOCALHOSTLIST
	int "# of host entries in the local host list"
	default 0
    depends on LWIP_DNS && DNS_LOCAL_HOSTLIST && DNS_LOCAL_HOSTLIST_IS_DYNAMIC

config PBUF_POOL_SIZE
	int "# of buffers in the pbuf pool"
	default 0

config MEMP_NUM_API_MSG
	int "# of active socket/netconn/tcpip calls"
	default MEMP_NUM_TCPIP_MSG_API

config MEMP_NUM_DNS_API_MSG
	int "# of active calls to netconn_gethostbyname"
	default MEMP_NUM_TCPIP_MSG_API
    depends on LWIP_DNS

config MEMP_NUM_SOCKET_SETGETSOCKOPT_DATA
	int "# of active calls to getsockopt/setsockopt"
	default MEMP_NUM_TCPIP_MSG_API

config MEMP_NUM_NETIFAPI_MSG
	int "# of active calls to the netifapi functions"
	default MEMP_NUM_TCPIP_MSG_API
    depends on LWIP_NETIF_API

config MEMP_NUM_MBUF_CACHE
       int "# of buffers in the mbuf cache pool"
       depends on NET80211
       default 25

config MEMP_NUM_MBUF_CHUNK
       int "# of buffers in the mbuf chunk pool"
       depends on NET80211
       default 5

config MEMP_NUM_MBUF_DYNA_EXT
       int "# of buffers in the mbuf dynamic ext. pool"
       depends on NET80211 && FREEBSD_MBUF_DYNA_EXT
       default 25

config MEMP_NUM_MDNS_TIMERS
       int "# of timers for mDNS responder"
	   depends on LWIP_MDNS_RESPONDER
	   default 8

config MEMP_NUM_SNTP_TIMERS
       int "# of timers for SNTP client"
	   depends on LWIP_SNTP
	   default 6

endmenu # Memory management
```
