## lib/lwip/Kconfig.socket
```kconfig
menuconfig BSD_SOCKET
       bool "BSD socket support"
       default y
       select LWIP_NETCONN

if BSD_SOCKET

choice
	prompt "Select socket implementation"

config WISE_SOCKET
       bool "WISE"
       select LWIP_NETCONN
       select USE_QUEUE_SETS
       select VFS
       help
        WISE socket is yet another BSD socket implementation based on LWIP sequential APIs,
	but is able to work with non-socket file descriptors for
        select()/poll(). These module uses posix header files in
        include/freebsd, not in lib/lwip/include.

config LWIP_SOCKET
 	bool "LwIP"
	select LWIP_NETCONN
	help
	 To use original LwIP socket API, enable this option (require to use sockets.c)"

endchoice

comment "Socket domain (family)"

config SOCK_FAMILY_INET
       bool "AF_INET domain"
       default y
       select LWIP_IPv4

config SOCK_FAMILY_INET6
       bool "AF_INET6 domain"
       default n
       select LWIP_IPv6

config SOCK_FAMILY_LINK
	bool "AF_LINK domain"
	default y
	select LWIP_LINK
	help
	 Say Y to enable link-layer domain socket.

comment "Socket types"
config SOCK_TYPE_STREAM
       bool "SOCK_STREAM type"
       default y
       select LWIP_TCP

config SOCK_TYPE_DGRAM
       bool "SOCK_DGRAM type"
       default y
       select LWIP_UDP
       select LWIP_RAW

config SOCK_TYPE_RAW
       bool "SOCK_RAW type"
       default y
       select LWIP_RAW
       help
        Say y to enable raw network protocol access

comment "Socket options"

config LWIP_SO_SNDTIMEO
	bool "SO_SNDTIMEO"
	default y
	help
	 Enable send timeout for sockets/netconns and SO_SNDTIMEO processing.

config LWIP_SO_RCVTIMEO
	bool "SO_RCVTIMEO"
	default y
	help
 	 Enable receive timeout for sockets/netconns and SO_RCVTIMEO processing.

config LWIP_SO_SNDRCVTIMEO_NONSTANDARD
	depends on LWIP_SOCKET && (LWIP_SO_SNDTIMEO || LWIP_SO_RCVTIMEO)
	bool "non-standard SO_SNDRCVTIMEO"
	default n
	help
 	 SO_RCVTIMEO/SO_SNDTIMEO take an int
 	 (milliseconds, much like winsock does) instead of a struct timeval (default).

config LWIP_SO_RCVBUF
	bool "SO_RCVBUF"
	default y

# opt.h
#config RECV_BUFSIZE_DEFAULT
#	int "Default receive buffer size"
#	default INT_MAX

config LWIP_SO_LINGER
	bool "SO_LINGER"
	default n

config SO_REUSE
	bool "SO_REUSEADDR"
	default y

config LWIP_TCP_KEEPALIVE
	bool "TCP keepalive"
	depends on SOCK_TYPE_STREAM
	default n
	help
 	 Enable TCP_KEEPIDLE, TCP_KEEPINTVL and TCP_KEEPCNT
 	 options processing. Note that TCP_KEEPIDLE and TCP_KEEPINTVL have to be set
 	 in seconds. (does not require sockets.c, and will affect tcp.c)

comment "Misc. options"

config LWIP_TCP_CLOSE_TIMEOUT_MS_DEFAULT
	depends on SOCK_STREAM
	int "TCP close timeout in miliseconds"
	default 20000
	help
	 By default, TCP socket/netconn close waits 20 seconds max to send the FIN

config SO_REUSE_RXTOALL
	depends on LWIP_SO_REUSEADDR
	bool "Clone incoming broadcast/multicast packets to all matching sockets"
	default n
	help
 	 Pass a copy of incoming broadcast/multicast packets
 	 to all local matches if SO_REUSEADDR is turned on.
 	 WARNING: Adds a memcpy for every packet if passing to more than one pcb!

config LWIP_FIONREAD_LINUXMODE
	bool "Linux FIONREAD ioctl"
	default n
	help
	 LWIP_FIONREAD_LINUXMODE==0: ioctl/FIONREAD returns the amount of
 	 pending data in the network buffer. This is the way windows does it. It is
 	 the default for lwIP since it is smaller.
 	 LWIP_FIONREAD_LINUXMODE==1: ioctl/FIONREAD returns the size of the next
 	 pending datagram in bytes. This is the way linux does it. This code is only
 	 here for compatibility.

if LWIP_SOCKET

comment "LWIP socket options"

config LWIP_COMPAT_SOCKETS
	int "Enable BSD-style sockets functions names through defines"
	default 1
	help
 	 LWIP_COMPAT_SOCKETS==2: Same as ==1 but correctly named functions are created.
 	 While this helps code completion, it might conflict with existing libraries.
 	 (only used if you use sockets.c)

config LWIP_POSIX_SOCKETS_IO_NAMES
	bool "Enable POSIX-style sockets functions names"
	default 1
	help
 	 Disable this option if you use a POSIX operating system that uses the same
 	 names (read, write & close). (only used if you use sockets.c)

config LWIP_SOCKET_OFFSET
	int "Socket file number descriptor offset"
	default 0
	help
	 Increases the file descriptor number created by LwIP with n.
 	 This can be useful when there are multiple APIs which create file descriptors.
 	 When they all start with a different offset and you will not make them overlap you can
 	 re implement read/write/close/ioctl/fnctl to send the requested action to the right
 	 library (sharing select will need more work though).

config LWIP_SOCKET_SELECT
	bool "Support select() for sockets"
	default 1
	help
	 Enable select() for sockets (uses a netconn callback to keep track of events).
 	 This saves RAM (counters per socket) and code (netconn event callback), which
 	 should improve performance a bit).

config LWIP_SOCKET_POLL
	bool "Support poll() for sockets"
	default 1
	help
	 Enable poll() for sockets (including struct pollfd, nfds_t, and constants)

endif # LWIP_SOCKET


endif # BSD_SOCKET
```

## lib/mbedtls-2.28.10/library/Kconfig
```kconfig
menuconfig MBEDTLS
	bool "mbedtls-2.28.10"
	default y
	depends on NET
	help
	 Enable MBEDTLS

if MBEDTLS

config MBEDTLS_AES_C
	bool "MBEDTLS_AES_C"
	default y
	help
     Enable the AES block cipher.

config MBEDTLS_SHA512_C
	bool "MBEDTLS_SHA512_C"
	default y
	help
     Enable the SHA-384 and SHA-512 cryptographic hash algorithms.

config MBEDTLS_ECP_C
	bool "MBEDTLS_ECP_C"
	default y
	help
     Enable the elliptic curve over GF(p) library.

config MBEDTLS_ECP_DP_SECP256R1_ENABLED
	bool "MBEDTLS_ECP_DP_SECP256R1_ENABLED"
	default y
	help
     Enables secp256r1 curve within the Elliptic Curve module.

config MBEDTLS_ECP_NIST_OPTIM
	bool "MBEDTLS_ECP_NIST_OPTIM"
	default y
	help
     Enable specific 'modulo p' routines for each NIST prime.

config MBEDTLS_DHM_C
	bool "MBEDTLS_DHM_C"
	default n
	help
	 Enable the elliptic curve Diffie-Hellman-Merkle module.

config MBEDTLS_ECDH_C
	bool "MBEDTLS_ECDH_C"
	default n
	help
	 Enable the elliptic curve Diffie-Hellman library.

config MBEDTLS_ECDSA_C
	bool "MBEDTLS_ECDSA_C"
	default n
	help
     Enable the elliptic curve DSA library.

config MBEDTLS_PEM_PARSE_C
	bool "MBEDTLS_PEM_PARSE_C"
	default y
	help
     Enable PEM decoding / parsing.

config MBEDTLS_SSL_PROTO_TLS1_2
	bool "MBEDTLS_SSL_PROTO_TLS1_2"
	default y
	help
     Enable support for TLS 1.2 (and DTLS 1.2 if DTLS is enabled).

config MBEDTLS_SSL_PROTO_TLS1_2
	bool "MBEDTLS_SSL_PROTO_TLS1_2"
	default y
	help
     Enable support for TLS 1.2 (and DTLS 1.2 if DTLS is enabled).

config MBEDTLS_SSL_PROTO_DTLS
	bool "MBEDTLS_SSL_PROTO_DTLS"
	default n
	help
     Enable support for DTLS (all available versions).

config MBEDTLS_SSL_ENCRYPT_THEN_MAC
	bool "MBEDTLS_SSL_ENCRYPT_THEN_MAC"
	default y
	help
     Enable support for Encrypt-then-MAC, RFC 7366.

config MBEDTLS_SSL_EXTENDED_MASTER_SECRET
	bool "MBEDTLS_SSL_EXTENDED_MASTER_SECRET"
	default y
	help
     Enable support for Extended Master Secret, aka Session Hash.

config MBEDTLS_SSL_TLS_C
	bool "MBEDTLS_SSL_TLS_C"
	default y
	help
     Enable the generic SSL/TLS code.

config MBEDTLS_TLS_CLIENT
	bool "MBEDTLS_TLS_CLIENT"
	default y
	help
     Enable the SSL/TLS client code.

config MBEDTLS_TLS_SERVER
	bool "MBEDTLS_TLS_SERVER"
	default y
	help
     Enable the SSL/TLS server code.

config MBEDTLS_KEY_EXCHANGE_RSA
	bool "MBEDTLS_KEY_EXCHANGE_RSA"
	default y
	help
     Enable the RSA-only based ciphersuite modes in SSL / TLS.

config MBEDTLS_KEY_EXCHANGE_ECDH_ECDSA
	bool "MBEDTLS_KEY_EXCHANGE_ECDH_ECDSA"
	default n
	help
     Enable the RSA-only based ciphersuite modes in SSL / TLS.

config MBEDTLS_KEY_EXCHANGE_ECDHE_ECDSA
	bool "MBEDTLS_KEY_EXCHANGE_ECDHE_ECDSA"
	default n
	help
     Enable the ECDH-ECDSA based ciphersuite modes in SSL / TLS.

config MBEDTLS_KEY_EXCHANGE_PSK
	bool "MBEDTLS_KEY_EXCHANGE_PSK"
	default n
	help
     Enable the PSK based ciphersuite modes in SSL / TLS.

config MBEDTLS_HAVE_TIME
	bool "MBEDTLS_HAVE_TIME"
	default y
	help
     System has time.h and time().

config MBEDTLS_HAVE_TIME_DATE
	bool "MBEDTLS_HAVE_TIME_DATE"
	default y
	help
     System has time.h, time(), and an implementation for mbedtls_platform_gmtime_r().

config MBEDTLS_CCM_C
	bool "MBEDTLS_CCM_C"
	default y
	help
     Enable the Counter with CBC-MAC (CCM) mode for 128-bit block cipher.

config MBEDTLS_TIMING_C
	bool "MBEDTLS_TIMING_C"
	default y
	help
     Enable the semi-portable timing interface.

config MBEDTLS_DEBUG
	bool "Enable debug"
	default n
	help
	 Enable the debug functions.

config MBEDTLS_CONFIG_FILE
	string "mbedTLS configuration file"
	default "mbedtls/config.h"

config MBEDTLS_NET_C_PORT
	bool "MBEDTLS_NET_C_PORT"
	default y
	select LWIP_DNS
	help
     Enable the TCP/IP wrapper.

endif
```

## lib/net/Kconfig
```kconfig
menu "net"

config DEFAULT_WLAN_MACADDR
	string "Default WLAN MAC address"
	default "64:f9:47:f0:01:20"
	help
	  MAC address to be used when eFuse doesn't provide it.


source "lib/net/http_parser/Kconfig"
source "lib/net/http_server/Kconfig"
source "lib/net/mqtt/Kconfig"
source "lib/net/coap/Kconfig"
source "lib/net/esp-tls/Kconfig"
source "lib/net/tcp-transport/Kconfig"
source "lib/net/esp_http_client/Kconfig"

endmenu
```

## lib/net/coap/Kconfig
```kconfig
menuconfig COAP
	bool "CoAP (Constrained Application Protocol"
	depends on LWIP
	default n
	help
	 Enable CoAP client and/or server.

if COAP

config COAP_CLIENT_SUPPORT
	bool "Support CoAP client"
	default y
    select MBEDTLS_TLS_CLIENT

config COAP_SERVER_SUPPORT
	bool "Support CoAP server"
	default y
    select MBEDTLS_TLS_SERVER

config COAP_OSCORE_SUPPORT
	bool "Support OSCORE as CoAP security"
	default n

config COAP_WEBSOCKETS
    bool "WebSockets"
    default n

config COAP_ASYNC_SUPPORT
    bool "Support delayed response"
	depends on COAP_SERVER_SUPPORT
    default n

config COAP_TCP_SUPPORT
    bool "Support TCP for transport"
	depends on LWIP_TCP
    default n

config COAP_Q_BLOCK
    bool "Support Q-Block (RFC9177)"
    default n

config COAP_OBSERVE_PERSIST
    bool "Manage subscription in persistent storage"
	depends on COAP_SERVER_SUPPORT
    default n

config COAP_WITH_MBEDTLS
    bool "Use mbedtls for CoAP security"
    default n

config COAP_DEBUGGING
    bool "Enable debugging"
    default n

config COAP_LOG_MAX_LEVEL
	int "Maximum logging level (0-8)"
	range 0 8
	default 0
	depends on COAP_DEBUGGING
	help
	 0: Emerg, 1: Alert, 2: Crit, 3: Err, 4: Warn, 5: Notice, 6: Info, 7: Debug, 8: OSCORE 

endif # COAP
```

## lib/net/mqtt/Kconfig
```kconfig
menuconfig MQTT
	bool "MQTT"
	depends on LWIP
	default n
	help
	 Enable MQTT client

if MQTT

menuconfig COREMQTT
    bool "coreMQTT - MQTT C client library"
    default n
    help
     Enable coreMQTT library.

if COREMQTT

source "lib/net/mqtt/coreMQTT/Kconfig"

endif

endif
```

## lib/net/mqtt/coreMQTT-Agent/Kconfig
```kconfig
config MQTT_AGENT_MAX_OUTSTANDING_ACKS
	int "Max. number of pending acks"
	default 20
	help
	 Maximum number of pending acks to track per a connection.

config MQTT_AGENT_MAX_EVENT_QUEUE_WAIT_TIME
	int "Max. event queue wait time in ms"
	default 0
	help
     Time in milliseconds that the MQTT agent task will wait
	 in the Blocked state (so not using any CPU time)
 	 for a command to arrive in its command queue
	 before exiting the blocked state so it can call MQTT_ProcessLoop().

config MQTT_AGENT_USE_QOS_1_2_PUBLISH
	bool "Allow QOS greater than 0"
	default true
	help
     Whether the agent should configure the coreMQTT library
	 to be used with publishes greater than QoS0.
```

## lib/net/mqtt/coreMQTT/Kconfig
```kconfig
config MQTT_SUB_UNSUB_MAX_VECTORS
    int "Max. number of vectors in subscribe and unsubscribe packet"
	default 4

config MQTT_MAX_CONNACK_RECEIVE_RETRY_COUNT
	int "The number of retries for receiving CONNACK"
	default 5
	help
     The MQTT_MAX_CONNACK_RECEIVE_RETRY_COUNT will be used only when the
     timeoutMs parameter of #MQTT_Connect is passed as 0 . The transport
     receive for CONNACK will be retried MQTT_MAX_CONNACK_RECEIVE_RETRY_COUNT
     times before timing out. A value of 0 for this config will cause the
     transport receive for CONNACK  to be invoked only once.

config MQTT_PINGRESP_TIMEOUT_MS
	int "Timeout duration for ping response in milliseconds"
	default 5000
	help
     Maximum number of milliseconds to wait for a ping response to a ping
     request as part of the keep-alive mechanism.

config PACKET_TX_TIMEOUT_MS
	int "Max. Tx inactivity in milliseconds"
	default 30000
	help
     Maximum number of milliseconds of TX inactivity to wait
     before initiating a PINGREQ.

config PACKET_RX_TIMEOUT_MS
	int "Max. Rx inactivity in milliseconds"
	default 30000
	help
     Maximum number of milliseconds of RX inactivity to wait
     before initiating a PINGREQ

config MQTT_RECV_POLLING_TIMEOUT_MS
	int "Max. polling duration"
	default 10
	help
    The maximum duration between non-empty network reads while
    receiving an MQTT packet via the MQTT_ProcessLoop or MQTT_ReceiveLoop
    API functions.

config MQTT_SEND_TIMEOUT_MS
	int "Max. duration of sending a MQTT packet"
	default 20000
	help
     The maximum duration allowed to send an MQTT packet over the transport
     interface.

menuconfig COREMQTT_AGENT
    bool "coreMQTT Agent - A thread-safe agent for coreMQTT"
    default y
    help
     Enable coreMQTT-Agent library.

if COREMQTT_AGENT

source "lib/net/mqtt/coreMQTT-Agent/Kconfig"

endif
```
