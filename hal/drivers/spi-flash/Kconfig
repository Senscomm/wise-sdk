## lib/ifconfig/Kconfig
```kconfig
menuconfig IFCONFIG
	bool "ifconfig"
	default y
	depends on LIBIFCONFIG

if IFCONFIG
config IFCONFIG_WIRELESS
	bool "Wireless commands"
	default y
	depends on NET80211

if IFCONFIG_WIRELESS

config IFCONFIG_SSID
	bool "ssid"
	default n

config IFCONFIG_CHANNEL
	bool "channel"
	default y
	select NET80211_IOC_CURCHAN

config IFCONFIG_AUTHMODE
	bool "authmode"
	default n

config IFCONFIG_POWERSAVE
	bool "powersave/-powersave/powersavelseep"
	default y

config IFCONFIG_HE_LTF_GI
	bool "heltfgi/-heltfgi"
	default y

config IFCONFIG_WME_FIX_AC
	bool "wme/-wme"
	default y

config IFCONFIG_RTSTHRESHOLD
	bool "rtsthreshold"
	default y

config IFCONFIG_PROTMODE
	bool "protmode"
	default n

config IFCONFIG_TXPOEWR
	bool "txpower"
	default y

config IFCONFIG_BSSID
	bool "bssid/ap"
	default n

config IFCONFIG_SCAN
	bool "scan/-scan"
	default y

config IFCONFIG_WMM
	bool "[bss:]cwmin/cwmax/aifs/txoplimit"
	default n

config IFCONFIG_ACK
	bool "ack/-ack"
	default n

config IFCONFIG_DTIMPERIOD
	bool "dtimperiod"
	default n

config IFCONFIG_BINTVAL
	bool "bcintval"
	default n

config IFCONFIG_MAXRETRY
	bool "maxretry"
	default n

config IFCONFIG_FRAGTHRESHOLD
	bool "fragthreshold"
	default n

config IFCONFIG_BURST
	bool "burst/-burst"
	default n

config IFCONFIG_BMISSTHRESHOLD
	bool "bmissthreshold"
	default n

config IFCONFIG_SHORTGI
	bool "shortgi/-shortgi"
	default n

config IFCONFIG_AMPDU
	bool "[-]ampdu/[-]ampdurx/[-]ampdutx/ampdulimit/ampdudensity"
	default n

config IFCONFIG_INACT
	bool "inact"
	default n

config IFCONFIG_HT
	bool "[-]ht[20|40]"
	default n

config IFCONFIG_RIFS
	bool "[-]rifs"
	default n

config IFCONFIG_LIST
	bool "list"
	default n

endif
endif
```

## lib/libifconfig/Kconfig
```kconfig
config LIBIFCONFIG
	depends on LWIP
	bool
	default y
	help
	 Include C APIs to implement functions in ifconfig
```

## lib/lwip/Kconfig
```kconfig
config LWIP
	bool "Enable lwIP TCP/IP stack"
	default y
	help
	 Include lwip port based on CMSIS-FreeRTOS
```
