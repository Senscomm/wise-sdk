## lib/hostap/wpa_supplicant/Kconfig
```kconfig
config WPA_SUPPLICANT
	bool
	depends on NET80211 && LWIP && LIBIFCONFIG
	select LIB_CRYPTO
	select MBEDTLS
	default y
	help
	 Say Y to add wpa_supplicant support

if WPA_SUPPLICANT

config CMD_WPA_SUPPLICANT
	bool
	default n

config CMD_WPA_CLI
	bool
	depends on WPA_CLI
	select CMD_WPA_CLI_VERBOSE
	default n

config CMD_WPA_CLI_VERBOSE
	bool
	depends on CMD_WPA_CLI
	default n

#
# Place holders for internal config/build variables
#


config NO_RADIUS
       bool
       default y
       select AES_WRAP

config NO_ACCOUNTING
       bool
       default y

config NO_VLAN
       bool
       default y

config P2P_STRICT
       bool
       default n

config ERP
       bool
       default n
       select SHA256
       select SHA256_KDF

config FIPS
       bool
       default n
       help
         Say Y to build with OpenSSL FIPS object module. Not supported by WISE

config EAP_VENDOR_TEST
       bool
       default n

config MACSEC
       bool
       default n
       select IEEE8021X_EAPOL
       select AES_ENCBLOCK
       select AES_UNWRAP
       select AES_WRAP
       select AES_OMAC1

config WNM_AP
       bool
       default n

config OFFCHANNEL
       bool
       default n

config GAS
       bool
       default n
       select OFFCHANNEL

config GAS_SERVER
       bool
       default n
       select GAS

config JSON
       bool
       default n

config MODULE_TEST
       bool
       default n

config CIPHER
       bool
       default n
       select DES

config MILENAGE
       bool
       default n
       select AES_ENCBLOCK

config AES
       bool
       default y

config AES_WRAP
       bool
       default y
       select AES_ENC

config AES_UNWRAP
       bool
       default n

config AES_EAX
       bool
       default n
       select AES_CTR
       select AES_OMAC1

config AES_SIV
       bool
       default n
       select AES_CTR
       select AES_OMAC1

config AES_CTR
       bool
       default n

config AES_ENCBLOCK
       bool
       default n

config AES_OMAC1
       bool
       default y
       select AES_ENC

config AES_CBC
       bool
       default n
       select AES_ENC

config AES_ENC
       bool
       default y

config SHA1
       bool
       default y

config NO_PBKDF2
       bool
       default n

config T_PRF
       bool
       default n

config TLS_PRF
       bool
       default n

config MD5
       bool
       default y

config MD4
       bool
       default n

config SHA256
       bool
       default y

config TLS_PRF_SHA256
       bool
       default n

config HMAC_SHA256_KDF
       bool
       default y
       select SHA256

config INTERNAL_SHA384
       bool
       default n

config SHA384
       bool
       default n
       select INTERNAL_SHA384

config HMAC_SHA384_KDF
       bool
       default n
       select SHA384

config INTERNAL_SHA512
       bool
       default n

config SHA512
       bool
       default n
       select INTERNAL_SHA512

config HMAC_SHA512_KDF
       bool
       default n
       select SHA512

config DH_GROUPS
       bool
       default n

config DH_GROUPS_ALL
       bool
       default n

config DES
       bool
       default n

config RC4
       bool
       default y

config NO_RC4
       bool
       default n

config ECC
       bool
       default y

config MS_FUNCS
       bool
       default n
       select DES
       select MD4

config CHAP
       bool
       default n

config BASE64
       bool
       default n

config MODEXP
       bool
       default n

config SUITEB
       bool
       default n
       select SHA256
       select AES_OMAC1

config SUITEB192
       bool
       default n
       select SHA384

config CRYPTO_INTERNAL
       bool
       default y
       select AES_ENC
       help
        Internal build system variable

config TLS_INTERNAL_CLIENT
       bool
       default n
       select CRYPTO_INTERNAL
       help
        Makefile variable hardwired to y

config INTERNAL_LIBTOMMATH
       bool
       default y
       help
        Makefile variable hardwired to y


## End of place holder ##

config IEEE80211N
	bool
	default y
	help

config IEEE80211R
	bool
	default n
	select SHA256
	select AES_OMAC1
	help
	 IEEE Std 802.11r-2008 (Fast BSS Transition) for station mode

config IEEE80211R_AP
	bool
	select IEEE80211R
	default n
	help
	 IEEE Std 802.11r-2008 (Fast BSS Transition) for AP mode

config MESH
	bool
	default n
	select SHA256
	select AES_SIV
	select SAE
	select AP
	help
	 Mesh Networking (IEEE 802.11s)

config INTERWORKING
	bool
	default n
	select GAS
	help
	 Interworking (IEEE 802.11u)
	 This can be used to enable functionality to improve interworking with
	 external networks (GAS/ANQP to learn more about the networks and network
	 selection based on available credentials).

config IEEE80211W
	bool
	default y
	select SHA256
	select AES_OMAC1
	help
	 IEEE 802.11w (management frame protection), also known as PMF.
	 NOTE: Driver support is also needed for IEEE 802.11w.

config BEACON_PROTECT
	bool
	default y
	depends on IEEE80211W

config OCV
	bool
	default y
	help
	 Operating Channel Validation (IEEE Std 802.11-2020)
	 Note: Driver support is also needed for OCV.

config WNM
	bool
	default n
	help
	 Wireless Network Management (IEEE Std 802.11v-2011)
	 Note: This is experimental and not complete implementation.

config IEEE80211AC
	bool
	depends on IEEE80211N
	default n
	help

config FILS
	bool
	default n
	select SHA384
	select AES_SIV
	help
	 Fast Initial Link Setup (FILS) (IEEE 802.11ai)
	 Note: This is an experimental and not yet complete implementation. This
	 should not be enabled for production use.

config FILS_SK_PFS
	bool
	default n
	depends on FILS
	select ECC
	help
	 FILS shared key authentication with PFS

config FST
	bool
	default n
	help
	 Enable Fast Session Transfer (FST)

config FST_TEST
	bool
	default n
	help
	 Enable CLI commands for FST testing

config IEEE80211AX
       bool
       default y

config OWE
       bool
       default n
       select ECC
       select HMAC_SHA256_KDF
       select HMAC_SHA384_KDF
       select HMAC_SHA512_KDF
       help
        Experimental implementation of draft-harkins-owe-07.txt

config HS20
	bool
	default n
	select INTERWORKING
	select AES_OMAC1
	help
	 Hotspot 2.0

config WPS
	bool
	default n
	select IEEE8021X_EAPOL
	select DH_GROUPS
	select SHA256
	select BASE64
	select AES_CBC
	select MODEXP
	help
	 Wi-Fi Protected Setup (WPS)

if WPS
config WPS_OOB
       bool
       default n

config WPS_UPNP
       bool
       default n

config WPS_STRICT
       bool
       default n

config WPS_REG_DISABLE_OPEN
       bool
       default n

config WPS_ER
	bool
	default n
	select WPS_UPNP
	help
	 Enable WPS external registrar functionality

config WPS_REG_DISABLE_OPEN
	bool
	default n
	help
	 Disable credentials for an open network by default when acting as a WPS
	 registrar.

config WPS_NFC
	bool
	default n
	select WPS_OOB
	help
	 Enable WPS support with NFC config method

endif

config DPP
       bool
       default n
       select AES_SIV
       select HMAC_SHA256_KDF
       select HMAC_SHA384_KDF
       select HMAC_SHA512_KDF
       select SHA256
       select SHA384
       select SHA512
       select JSON
       select GAS_SERVER
       select BASE64

config P2P
	bool
	default n
	select WPS
	select AP
	select GAS
	select OFFCHANNEL
	select TDLS
	help
	 P2P (Wi-Fi Direct)
	 This can be used to enable P2P support in wpa_supplicant. See README-P2P for
	 more information on P2P operations.
	 Enable TDLS support

config TDLS
	bool
	default n
	select SHA256
	select AES_OMAC1
	help

config WIFI_DISPLAY
	bool
	default n
	help
	 Wi-Fi Direct
	 This can be used to enable Wi-Fi Direct extensions for P2P using an external
	 program to control the additional information exchanges in the messages.

config MBO
	bool
	default n
	select WNM
	help
	 Support Multi Band Operation

config WPA
       bool
       default y
       select AES
       select SHA1
       select MD5
       select RC4
       help
        Say Y to enable WPA/WPA2 support. This increases code size by 35-50 kB.

config WEP
       bool
       default y
       help
        Say Y to enable WEP support.

config SAE
	bool
	select ECC
	select SME
	select HMAC_SHA256_KDF
	default y
	help
	 Enable WPA3(SAE) support.

if SAE
config SAE_PWE
	int
	range 0 2
	default 2
	help
	 0: hunting-and-pecking loop only
	 1: hash-to-element only
	 2: both hunting-and-pecking loop and hash-to-element enabled
endif

config WPA_PASSPHRASE
	bool
	depends on WPA
	default y
	help
	 Remove IEEE 802.11i/WPA-Personal ASCII passphrase support
	 This option can be used to reduce code size by removing support for
	 converting ASCII passphrases into PSK. If this functionality is removed, the
	 PSK can only be configured as the 64-octet hexstring (e.g., from
	 wpa_passphrase). This saves about 0.5 kB in code size. If unsure, say N.

config NO_WPA
       bool
       default n
       select SHA1
       select MD5
       help
        Internal Makefile variable

config NO_WPA_PASSPHRASE
       bool
       default n
       select NO_PBKDF2
       help
        Internal Makefile variable

config EAP_COMMON
       bool
       default y

config IEEE8021X_EAPOL
	bool
	default n
	select EAP_COMMON
	help
	 Enable IEEE 802.1X Supplicant. For WPA/WPA2-Personal only, say N.

if IEEE8021X_EAPOL

# EAP-MD5
config EAP_MD5
	bool
	default n
	select CHAP
	help

# EAP-MSCHAPv2
config EAP_MSCHAPV2
	bool
	default n
	select MS_FUNCS
	help

# EAP-TLS
config EAP_TLS
	bool
	default n
	select TLS_FUNCS
	help

config EAP_UNAUTH_TLS
       bool
       default n
       select EAP_TLS
       select TLS_FUNCS

# EAL-PEAP
config EAP_PEAP
	bool
	default n
	select TLS_FUNCS
	help

# EAP-TTLS
config EAP_TTLS
	bool
	default n
	select TLS_FUNCS
	select MS_FUNCS
	select CHAP
	help

config EAP_FAST
	bool
	default n
	select TLS_FUNCS
	select T_PRF
	help
	 EAP-FAST
	 Note: If OpenSSL is used as the TLS library, OpenSSL 1.0 or newer is needed
	 for EAP-FAST support. Older OpenSSL releases would need to be patched, e.g.,
	 with openssl-0.9.8x-tls-extensions.patch, to add the needed functions.

config EAP_GTC
	bool
	default n
	help

config EAP_OTP
	bool
	default n
	help

config EAP_SIM
	bool
	default n
	select PCSC
	select EAP_SIM_COMMON
	select AES_CBC
	help

config EAP_PSK
	bool
	default n
	select AES
	select AES_OMAC1
	select AES_ENBLOCK
	select AES_EAX
	help
	 This is not needed for WPA-PSK

config EAP_PWD
	bool
	default n
	select SHA256
	select ECC
	help
	 EAP-pwd (secure authentication using only a password)

config EAP_PAX
	bool
	default n
	help

config EAP_LEAP
	bool
	default n
	select MS_FUNCS
	help

config EAP_SIM_COMMON
       bool
       default n
       select AES
       select FIPS186_2_PRF
       help
        Kbuild internal. Not supported by WISE

config EAP_AKA
	bool
	default n
	select PCSC
	select EAP_SIM_COMMON
	select AES_CBC
	help
	 Not supported by WISE because of FIPS186_2_PRF requires OpenSSL

config EAP_AKA_PRIME
	bool
	default n
	select PCSC
	select EAP_AKA
	select SHA256
	help
	 Not supported by WISE because of FIPS186_2_PRF requires OpenSSL.

config USIM_SIMULATOR
	bool
	default n
	select MILENAGE
	help
	 Enable USIM simulator (Milenage) for EAP-AKA

config EAP_SAKE
	bool
	default n
	help

config EAP_GPSK
	bool
	default n
	select SHA256
	select AES_OMAC1
	help

config EAP_GPSK_SHA256
	bool
	default n
	help
	 Include support for optional SHA256 cipher suite in EAP-GPSK

config EAP_TNC
	bool
	default n
	select BASE64
	help
	 EAP-TNC and related Trusted Network Connect support (experimental)

config EAP_IKEV2
	bool
	default n
	select DH_GROUPS
	select DH_GROUPS_ALL
	select MODEXP
	select CIPHER
	help

config EAP_EKE
	bool
	default n
	select DH_GROUPS
	select DH_GROUPS_ALL
	select SHA256
	select AES_CBC
	help

config PKCS12
	bool
	default n
	help
	 PKCS#12 (PFX) support (used to read private key and certificate file from
	 a file that usually has extension .p12 or .pfx)

config SMARTCARD
	bool
	default n
	help
	 Smartcard support (i.e., private key on a smartcard), e.g., with openssl
	 engine.

config PCSC
	bool
	default n
	help
	 PC/SC interface for smartcards (USIM, GSM SIM)
	 Enable this if EAP-SIM or EAP-AKA is included

endif # IEEE8021X_EAPOL

config IBSS_RSN
	bool
	default n
	select NO_VLAN
	select NO_RADIUS
	help
	 Support RSN on IBSS networks
	 This is needed to be able to use mode=1 network profile with proto=RSN and
	 key_mgmt=WPA-PSK (i.e., full key management instead of WPA-None).

config PMKSA_CACHE_EXTERNAL
	bool
	default n
	help
	 External PMKSA cache control
	 This can be used to enable control interface commands that allow the current
	 PMKSA cache entries to be fetched and new entries to be added.

config DELAYED_MIC_ERROR_REPORT
	bool
	default n
	help
	 Enable mitigation against certain attacks against TKIP by delaying Michael
	 MIC error reports by a random amount of time between 0 and 60 seconds


config EAPOL_TEST
	bool
	default n
	help
	 Development testing

config TLS_FUNCS
       bool
       default n
       select DES
       select TLS_PRF
       select SHA1
       select MD5
       select SHA256
       select SHA384
       select SHA512
       select BASE64
       select TLS_PRF_SHA256 if TLSV12
       select MODEXP
       select CIPHER
       select TLS_INTERNAL_CLIENT
       help
        Makefile variable

config TLSV11
	bool
	default n
	depends on TLS_FUNCS
	help
	 TLS-based EAP methods require at least TLS v1.0. Newer version of TLS (v1.1)
	 can be enabled to get a stronger construction of messages when block ciphers
	 are used. It should be noted that some existing TLS v1.0 -based
	 implementation may not be compatible with TLS v1.1 message (ClientHello is
	 sent prior to negotiating which version will be used)

config TLSV12
	bool
	default n
	depends on TLS_FUNCS
	select SHA256
	help
	 TLS-based EAP methods require at least TLS v1.0. Newer version of TLS (v1.2)
	 can be enabled to enable use of stronger crypto algorithms. It should be
	 noted that some existing TLS v1.0 -based implementation may not be compatible
	 with TLS v1.2 message (ClientHello is sent prior to negotiating which version
	 will be used)

config NO_SCAN_PROCESSING
	bool
	default n
	help
	 Disable scan result processing (ap_mode=1) to save code size by about 1 kB.
	 This can be used if ap_scan=1 mode is never enabled.

config AUTOSCAN
       bool
       default y
       help
        Autoscan
        This can be used to enable automatic scan support in wpa_supplicant.
        See wpa_supplicant.conf for more information on autoscan usage.

if AUTOSCAN
config AUTOSCAN_EXPONENTIAL
	bool
	default y
	help

config AUTOSCAN_PERIODIC
	bool
	default n
	help
	 For periodic module

endif # AUTOSCAN

config NO_ROAMING
	bool
	default n
	help
	 Disable roaming in wpa_supplicant

config BGSCAN
       bool
          default n
       depends on !NO_ROAMING
       help
        Background scanning modules
        These can be used to request wpa_supplicant to perform background scanning
        operations for roaming within an ESS (same SSID). See the bgscan parameter in
        the wpa_supplicant.conf file for more details.
        Periodic background scans based on signal strength

if BGSCAN
config BGSCAN_SIMPLE
	bool
	default n
	help

config BGSCAN_LEARN
	bool
	default n
	help
	 Learn channels used by the network and try to avoid bgscans on other
	 channels (experimental)

endif #BGSCAN

config SCAN_RESULTS_SIZE
	int
	default 12288
	help
	 Size in bytes of scan result buffer.
	 Scan performance might be affected by this setting.

config WPA_SUPPLICANT_CTRL_CMD_SIZE
	int
	default 2048
	help
	 Size in bytes of buf for cmd and reply result.

config SCAN_NON_ITERATE
	bool
	default y

config OPTIMIZE_SUPPLICANT_SCAN_ENTRY
	bool
	default y

config AP
	bool
	default y
	select EAP_COMMON
	select NO_RADIUS
	select NO_ACCOUNTING
	select NO_VLAN
	help
	 AP mode operations with wpa_supplicant
	 This can be used for controlling AP mode operations with wpa_supplicant. It
	 should be noted that this is mainly aimed at simple cases like
	 WPA2-Personal while more complex configurations like WPA2-Enterprise with an
	 external RADIUS server can be supported with hostapd.

if AP
config SUPPORT_STA_NUM
	int "softap support number of sta"
	range 1 4
	default 1
endif

config BACKEND_FILE
       bool
          default y

config BACKEND_NONE
       bool
          default n
if BACKEND_FILE

config CONFIG_WRITE
	bool
	default y
	help
	 Enable configuration write functionality (i.e., to allow the configuration
	 file to be updated based on runtime configuration changes). The runtime
	 configuration can still be changed, the changes are going to be
	 persistent over restarts. This option can increase code size by
	 about 3.5 kB.

config CONFIG_BLOBS
	bool
	default n
	select BASE64
	help
	 Enable support for configuration blobs write. Code size is increased by
	 about 1.5 kB.

endif #BACKEND_FILE

config NO_CONFIG_WRITE
       bool
       default n

config NO_CONFIG_BLOBS
       bool
       default y

#
# Configuration items (WISE-specific configurations)
#
#

config CONFIG_CREDENTIAL
       bool
       default n
       help
        Say Y to change credential related settings


config CONF_NO_OPT_PARAMS
       bool
       default y
       help
        Say Y to use only fixed default values for all optional parameters


if !CONF_NO_OPT_PARAMS

config CONF_BSSID_BLACKLIST
       bool
       default n

config CONF_BSSID_WHITELIST
       bool
       default n

config CONF_MEM_ONLY_PSK
       bool
       default n

config CONF_SAE_PASSWORD
       bool
       default n

config CONF_BG_SCAN_PERIOD
       bool
       default n

config CONF_GROUP_MGMT
       bool
       default n

config CONF_VHT
       bool
       default n

config CONF_MAX_OPER_WIDTH
       bool
       default n

config CONF_VHT_CENTER_FREQ1
       bool
       default n

config CONF_VHT_CENTER_FREQ2
       bool
       default n

config CONF_PRIORITY
       bool
       default n

config CONF_PROACTIVE_KEY_CACHING
       bool
       default n

config CONF_DISABLED
       bool
       default n

config CONF_ID_STR
       bool
       default n

config CONF_PEERKEY
       bool
       default n

config CONF_MIXED_CELL
       bool
       default n

config CONF_FIXED_FREQ
       bool
       default n

config CONF_WPA_PTK_REKEY
       bool
       default n

config CONF_GROUP_REKEY
       bool
       default n

config CONF_BGSCAN
       bool
       default n

config CONF_IGNORE_BROADCAST_SSID
       bool
       default n

config CONF_AP_MAX_INACTIVITY
       bool
       default n

config CONF_DTIM_PERIOD
       bool
       default n

config CONF_BEACON_INT
       bool
       default n

config CONF_MAC_ADDR
       bool
       default n

config CONF_PBSS
       bool
       default n

config CONF_WPS_DISABLED
       bool
       default n

config CONF_FILS_DH_GROUP
       bool
       default n

config CONF_OWE_GROUP
       bool
       default n

config CONF_OWE_ONLY
       bool
       default n

endif

config CTRL_IFACE
	bool
	default y
	help
	 Select control interface backend for external programs, e.g, wpa_cli:
	 unix = UNIX domain sockets (default for Linux/*BSD)
	 udp = UDP sockets using localhost (127.0.0.1)
	 udp-remote = UDP sockets with remote access (only for tests systems/purpose)
	 If this option is commented out, control interface is not included in the
	 build.

if CTRL_IFACE
config CTRL_IFACE_UDP
       bool
       default y
       help
        Say Y to enable UDP control interface

config CTRL_IFACE_UDP_REMOTE
       bool
       select CTRL_IFACE_UDP
       default n
       help
        Say Y to enable UDP remote control interface

#
# WISE-specific customization
# List of core and optional commands
#

config CTRL_IFACE_CMD_LIST_NETWORKS
       bool
       default y

config CTRL_IFACE_CMD_GET_NETWORK
       bool
       default y

config CTRL_IFACE_CMD_SCAN_RESULTS
       bool
       default y

config CTRL_IFACE_CMD_HELP
       bool
       default y

config CTRL_IFACE_CMD_SELECT_NETWORK
       bool
       default y

config CTRL_IFACE_CMD_ENABLE_NETWORK
       bool
       default y

config CTRL_IFACE_CMD_DISABLE_NETWORK
       bool
       default y

config CTRL_IFACE_CMD_ADD_NETWORK
       bool
       default y

config CTRL_IFACE_CMD_REMOVE_NETWORK
       bool
       default y

config CTRL_IFACE_CMD_SET_NETWORK
       bool
       default y

config CTRL_IFACE_CMD_DUP_NETWORK
       bool
       default y

config CTRL_IFACE_CMD_DISCONNECT
       bool
       default y

config CTRL_IFACE_CMD_RECONNECT
       bool
       default y

config CTRL_IFACE_CMD_SCAN
       bool
       default y

config CTRL_IFACE_CMD_ABORT_SCAN
       bool
       default y

config CTRL_IFACE_CMD_STA
       bool
       default y

config CTRL_IFACE_CMD_ALL_STA
       bool
       default y

config CTRL_IFACE_CMD_LIST_STA
       bool
       default y

config CTRL_IFACE_CMD_DEAUTHENTICATE
       bool
       default y

config CTRL_IFACE_CMD_DISASSOCIATE
       bool
       default y

config CTRL_IFACE_CMD_CHAN_SWITCH
       bool
       default y

config CTRL_IFACE_CMD_SUSPEND
       bool
       default y

config CTRL_IFACE_CMD_RESUME
       bool
       default y

config CTRL_IFACE_NO_GET_COMMANDS
       bool
       default y
       help
        Say Y to remove all "get" style optional ctrl iface commands


if !CTRL_IFACE_NO_GET_COMMANDS

config CTRL_IFACE_CMD_STATUS
       bool
       default n

config CTRL_IFACE_CMD_IFNAME
       bool
       default n

config CTRL_IFACE_CMD_MIB
       bool
       default n

config CTRL_IFACE_CMD_DUMP
       bool
       default n

config CTRL_IFACE_CMD_GET
       bool
       default n

config CTRL_IFACE_CMD_INTERFACE
       bool
       default n

config CTRL_IFACE_CMD_DRIVER_FLAGS
       bool
       default n

config CTRL_IFACE_CMD_BSS
       bool
       default n

config CTRL_IFACE_CMD_GET_CAPABILITY
       bool
       default n

config CTRL_IFACE_CMD_WMM_AC_STATUS
       bool
       default n

config CTRL_IFACE_CMD_GET_PREF_FREQ_LIST
       bool
       default n

endif

config CTRL_IFACE_NO_SET_COMMANDS
       bool
       default y
       help
        Say Y to remove all "set" style optional ctrl iface commands


if !CTRL_IFACE_NO_SET_COMMANDS

config CTRL_IFACE_CMD_AUTOSCAN
       bool
       default n

config CTRL_IFACE_CMD_PING
       bool
       default n

config CTRL_IFACE_CMD_LOGON
       bool
       default n

config CTRL_IFACE_CMD_LOGOFF
       bool
       default n

config CTRL_IFACE_CMD_PMKSA_FLUSH
       bool
       default n

config CTRL_IFACE_CMD_REASSOCIATE
       bool
       default n

config CTRL_IFACE_CMD_REATTACH
       bool
       default n

config CTRL_IFACE_CMD_BSSID
       bool
       default n

config CTRL_IFACE_CMD_BLACKLIST
       bool
       default n

config CTRL_IFACE_CMD_LOG_LEVEL
       bool
       default n

config CTRL_IFACE_CMD_RECONFIGURE
       bool
       default n

config CTRL_IFACE_CMD_TERMINATE
       bool
       default n

config CTRL_IFACE_CMD_INTERFACE_ADD
       bool
       default n

config CTRL_IFACE_CMD_INTERFACE_REMOVE
       bool
       default n

config CTRL_IFACE_CMD_INTERFACE_LIST
       bool
       default n

config CTRL_IFACE_CMD_AP_SCAN
       bool
       default n

config CTRL_IFACE_CMD_SCAN_INTERVAL
       bool
       default n

config CTRL_IFACE_CMD_BSS_EXPIRE_AGE
       bool
       default n

config CTRL_IFACE_CMD_BSS_EXPIRE_COUNT
       bool
       default n

config CTRL_IFACE_CMD_BSS_FLUSH
       bool
       default n

config CTRL_IFACE_CMD_ROAM
       bool
       default n

config CTRL_IFACE_CMD_VENDOR_ELEM_ADD
       bool
       default n

config CTRL_IFACE_CMD_VENDOR_ELEM_GET
       bool
       default n

config CTRL_IFACE_CMD_VENDOR_ELEM_REMOVE
       bool
       default n

config CTRL_IFACE_CMD_STA_AUTOCONNECT
       bool
       default n

config CTRL_IFACE_CMD_WMM_AC_ADDTS
       bool
       default n

config CTRL_IFACE_CMD_WMM_AC_DELTS
       bool
       default n

config CTRL_IFACE_CMD_SIGNAL_POLL
       bool
       default n

config CTRL_IFACE_CMD_SIGNAL_MONITOR
       bool
       default n

config CTRL_IFACE_CMD_PKTCNT_POLL
       bool
       default n

config CTRL_IFACE_CMD_REAUTHENTICATE
       bool
       default n

config CTRL_IFACE_CMD_FLUSH
       bool
       default n

config CTRL_IFACE_CMD_RADIO_WORK
       bool
       default n

config CTRL_IFACE_CMD_NEIGHBOR_REP_REQUEST
       bool
       default n

config CTRL_IFACE_CMD_ERP_FLUSH
       bool
       default n

config CTRL_IFACE_CMD_MAC_RAND_SCAN
       bool
       default n

endif

endif

config ELOOP_POLL
	bool
    default n
	help
	 Say Y to use poll() instead of select().


config NO_STDOUT_DEBUG
	bool
	default y
	help
	 Remove debugging code that is printing out debug message to stdout.
	 This can be used to reduce the size of the wpa_supplicant considerably
	 if debugging code is not needed. The size reduction can be around 35%
	 (e.g., 90 kB).

config NO_WPA_MSG
       bool
       default y

config NO_HOSTAPD_LOGGER
       bool
       default y

config NO_WPA_AUTH_LOGGER
       bool
       default y

config SME
       bool
       default y

config HT_OVERRIDES
	bool
	default n
	help
	 Say Y to disable HT/HT40 or mask MCS rates, etc. Say N if unsure.

config VHT_OVERRIDES
	bool
	default n
	help
	 Say Y to disable VHT, or mask MCS rates, etc. Say N if unsure.

config MATCH_IFACE
	bool
	default n
	help
	 Enable interface matching in wpa_supplicant. Say N if unsure.

config EXT_PASSWORD
       bool
       default n

config EXT_PASSWORD_TEST
	bool
	default n
	select EXT_PASSWORD
	help
	 Password (and passphrase, etc.) backend for external storage
	 These optional mechanisms can be used to add support for storing passwords
	 and other secrets in external (to wpa_supplicant) location. This allows, for
	 example, operating system specific key storage to be used
	 External password backend for testing purposes (developer use)

config WPA_CLI
	bool
	default y

config WPA_CLI_INTERACTIVE
	bool
	depends on WPA_CLI
	default y

#
# Hardwired configuration
#
config DRIVER_BSD
       bool
       default y

config NO_RANDOM_POOL
	bool
	default y
	help
	 wpa_supplicant depends on strong random number generation being available
	 from the operating system. os_get_random() function is used to fetch random
	 data when needed, e.g., for key generation. On Linux and BSD systems, this
	 works by reading /dev/urandom. It should be noted that the OS entropy pool
	 needs to be properly initialized before wpa_supplicant is started. This is
	 important especially on embedded devices that do not have a hardware random
	 number generator and may by default start up with minimal entropy available
	 for random number generation.
	 As a safety net, wpa_supplicant is by default trying to internally collect
	 additional entropy for generating random data to mix in with the data fetched
	 from the OS. This by itself is not considered to be very strong, but it may
	 help in cases where the system pool is not initialized properly. However, it
	 is very strongly recommended that the system pool is initialized with enough
	 entropy either by using hardware assisted random number generator or by
	 storing state over device reboots.
	 wpa_supplicant can be configured to maintain its own entropy store over
	 restarts to enhance random number generation. This is not perfect, but it is
	 much more secure than using the same sequence of random numbers after every
	 reboot. This can be enabled with -e<entropy file> command line option. The
	 specified file needs to be readable and writable by wpa_supplicant.
	 If the os_get_random() is known to provide strong random data (e.g., on
	 Linux/BSD, the board in question is known to have reliable source of random
	 data from /dev/urandom), the internal wpa_supplicant random pool can be
	 disabled. This will save some in binary size and CPU use. However, this
	 should only be considered for builds that are known to be used on devices
	 that meet the requirements described above.

config INTERNAL_LIBTOMMATH
	bool
	default y
	help
	 If CONFIG_TLS=internal is used, additional library and include paths are
	 needed for LibTomMath. Alternatively, an integrated, minimal version of
	 LibTomMath can be used. See beginning of libtommath.c for details on benefits
	 and drawbacks of this option.

config INTERNAL_LIBTOMMATH_FAST
	bool
	default n
	help
	 At the cost of about 4 kB of additional binary size, the internal LibTomMath
	 can be configured to include faster routines for exptmod, sqr, and div to
	 speed up DH and RSA calculation considerably


#
# Not supported configurations
#
config ACS
	bool
	default n
	help
	 Automatic Channel Selection
	 This will allow wpa_supplicant to pick the channel automatically when channel
	 is set to "0".

	 TODO: Extend parser to be able to parse "channel=acs_survey" as an alternative
	 to "channel=0". This would enable us to eventually add other ACS algorithms in
	 similar way.

	 Automatic selection is currently only done through initialization, later on
	 we hope to do background checks to keep us moving to more ideal channels as
	 time goes by. ACS is currently only supported through the nl80211 driver and
	 your driver must have survey dump capability that is filled by the driver
	 during scanning.

	 TODO: In analogy to hostapd be able to customize the ACS survey algorithm with
	 a newly to create wpa_supplicant.conf variable acs_num_scans.

	 Supported ACS drivers:
	 * ath9k
	 * ath5k
	 * ath10k

	 For more details refer to:
	 http://wireless.kernel.org/en/users/Documentation/acs

config READLINE
	bool
	default n
	help
	 Include support for GNU Readline and History Libraries in wpa_cli.
	 When building a wpa_cli binary for distribution, please note that these
	 libraries are licensed under GPL and as such, BSD license may not apply for
	 the resulting binary.
	 This feature is not supported

config WPA_CLI_EDIT
	bool
	default n
	help
	 Include internal line edit mode in wpa_cli. This can be used as a replacement
	 for GNU Readline to provide limited command line editing and history support.
	 This feature is not supported

config NO_LINUX_PACKET_SOCKET_WAR
	bool
	default n
	help
	 Disable Linux packet socket workaround applicable for station interface
	 in a bridge for EAPOL frames. This should be uncommented only if the kernel
	 is known to not have the regression issue in packet socket behavior with
	 bridge interfaces (commit 'bridge: respect RFC2863 operational state')').

# Select which ciphers to use by default with OpenSSL if the user does not
# specify them.
#CONFIG_TLS_DEFAULT_CIPHERS="DEFAULT:!EXP:!LOW"

config DEBUG_SYSLOG
	bool
	default n
	help
	 Send debug messages to syslog instead of stdout

config DEBUG_LINUX_TRACING
	bool
	default n
	help
	 Add support for sending all debug messages (regardless of debug verbosity)
	 to the Linux kernel tracing facility. This helps debug the entire stack by
	 making it easy to record everything happening from the driver up into the
	 same file, e.g., using trace-cmd.

config ELOOP_EPOLL
	bool
	default n
	help
	 Say Y to use epoll instead of select? Select is used by default.

config ELOOP_KQUEUE
	bool
	default n
	help
	 Say Y to use kqueue instead of select? Select is used by default (not supported).

endif
```
