## lib/at/Kconfig
```kconfig
menuconfig AT
	bool "AT commands"
	select WISE_API
	select CMD_AT
	default n
	help
	 Enable WISE at commands.

if AT

config AT_UART_PORT
    int "UART port # for AT"
    default 0

config AT_OVER_IPC
	bool
	default n

config AT_OVER_SCDC
	bool "AT over SCDC"
	default n

comment "System AT commands"

config ATCMD_AT
	bool "\"AT\" : Tests if AT is enabled"
	default y

config ATCMD_AT_RST
	bool "\"AT+RST\" : Restart system"
	default y

config ATCMD_AT_CMD
	bool "\"AT+CMD\" : List AT CMDs"
	default y

config ATCMD_ATE
	bool "\"ATE\" : Switch echo on or off"
	default y
	help
	 ATE0/ATE1 will turn echo off, on respectively

config ATCMD_AT_UART_CUR
	bool "\"AT+UART_CUR\" : Current UART Configuration"
	default y

config ATCMD_AT_SYSRAM
	bool "\"AT+SYSRAM\" : Get currently free heap memory size"
	default y

config ATCMD_AT_SLEEP
	bool "\"AT+SLEEP\" : Set the Sleep Mode"
	default y

config ATCMD_AT_SLEEPWKCFG
	bool "\"AT+SLEEPWKCFG\" : Set the Wakeup Source"
	default y

config ATCMD_AT_GSLP
	bool "\"AT+GSLP\" : Enter into the deep sleep mode"
	default y

config ATCMD_AT_PME
	bool "\"AT+PME\" : Enable/Disable WISE pm"
	default n

config ATCMD_AT_PMEW
	bool "\"AT+PMEW\" : Enable/Disable WISE WLAN pm"
	default n

config ATCMD_AT_PMES
	bool "\"AT+PMES\" : Enable/Disable PM state LS/DS/HI"
	default n

config ATCMD_AT_PMEWU
	bool "\"AT+PMEWU\" : Enable/Disable PM wakeup GPIO"
	default n

config ATCMD_AT_PMR
	bool "\"AT+PMR\" : Register/Unregister PM cb through system cmd"
	default n

comment "Wi-Fi AT commands"

config ATCMD_AT_CWMAC
	bool "\"AT+CWMAC\" : Set/Query the Wi-Fi mac address to interface"
	default y

config ATCMD_AT_CWMODE
	bool "\"AT+CWMODE\" : Set/Query the Wi-Fi mode (Station/SoftAP)"
	default y

config ATCMD_AT_CWSTR
	bool "\"AT+CWSTR\" : Exec the network enable (Station/SoftAP)"
	default y

config ATCMD_AT_CWSTOP
	bool "\"AT+CWSTOP\" : Exec the network disable (Station/SoftAP)"
	default y

config ATCMD_AT_CWSCAP
	bool "\"AT+CWSCAP\" : Exec the network enable (Station)"
	default y

config ATCMD_AT_CWDHCP
	bool "\"AT+CWDHCP\" : Enable/Disable/Query DHCP for Station mode/SoftAP mode"
	default y

config ATCMD_AT_CWDHCPS
	bool "\"AT+CWDHCPS\" : Set/Query IP Address range for SoftAP mode"
	default y

config ATCMD_AT_CWLIF
	bool "\"AT+CWLIF\" : Show IP of Stations for AP mode"
	default y

config ATCMD_AT_CWLAP
	bool "\"AT+CWLAP\" : Show Available APs"
	default y

config ATCMD_AT_CWLAPN
	bool "\"AT+CWLAPN\" : Show Number of Available AP"
	default y

config ATCMD_AT_CWSSCN
	bool "\"AT+CWSSCN\" : Exec Stop Scan"
	default y

config ATCMD_AT_CWCOUNTRY
	bool "\"AT+CWCOUNTRY\" : Set Country"
	default y

config ATCMD_AT_CWPS
	bool "\"AT+CWPS\" : Set Power Save mode"
	default y

config ATCMD_AT_CWPWR
	bool "\"AT+CWPWR\" : Set Max Power Limited"
	default y

config ATCMD_AT_CWLAPOPT
	bool "\"AT+CWLAPOPT\" : Set show elements in \"AT+CWLAP\""
	depends on ATCMD_AT_CWLAP
	default y

config ATCMD_AT_CWSAP
	bool "\"AT+CWSAP\" : Set/Query Configuration for SoftAP mode"
	default y

config ATCMD_AT_CWJAP
	bool "\"AT+CWJAP\" : Exec ssid password bssid configuration"
	default y

config ATCMD_AT_CWQAP
	bool "\"AT+CWQAP\" : Disconnects from the AP"
	default y

config ATCMD_AT_CWSMART
	bool "\"AT+CWSTARTSMART\" : Start SMARTCONFIG , \"AT+CWSTOPSMART\" : Stop SMARTCONFIG"
	default y
	depends on AIRKISS

comment "TCP/IP AT commands"

config ATCMD_AT_CIFSR
	bool "\"AT+CIFSR\" : Retrieves the IP Address and MAC Address"
	default y

config ATCMD_AT_CIPSTA
	bool "\"AT+CIPSTA\" : Set/Query the IP Address for Station mode"
	default y

config ATCMD_AT_CIPSTAMAC
	bool "\"AT+CIPSTAMAC\" : Set/Query the MAC Address for Station mode"
	default y

config ATCMD_AT_CIPAP
	bool "\"AT+CIPAP\" : Set/Query the IP Address for AP mode"
	default y

config ATCMD_AT_CIPAPMAC
	bool "\"AT+CIPAPMAC\" : Set/Query the MAC Address for AP mode"
	default y

config ATCMD_AT_PING
	bool "\"AT+PING\" : Ping"
	default y

config ATCMD_AT_CIPSTART
	bool "\"AT+CIPSTART\" : Set up a TCP/UDP/SSL connection"
	select TCP_TRANSPORT
	select ESP_TLS
	select ESP_TLS_INSECURE
	select ESP_TLS_SKIP_SERVER_CERT_VERIFY
	default y

config ATCMD_AT_CIPCLOSE
	bool "\"AT+CIPCLOSE\" : Close a TCP/UDP/SSL connection"
	default y

config ATCMD_AT_CIPDINFO
	bool "\"AT+CIPDINFO\" : Show the remote ip address and port"
	default y

config ATCMD_AT_CIPSEND
	bool "\"AT+CIPSEND\" : Send data"
	default y

if ATCMD_AT_CIPSEND
config AT_CIPSEND_MAX
	int "Maximum bytes to be sent via \"AT+CIPSEND\""
	default 2048
endif

config ATCMD_AT_CIPSTATUS
	bool "\"AT+CIPSTATUS\" : Get connection status"
	default y

config ATCMD_AT_APDHCP_AUTO
	bool "\"AT+APDHCP_AUTO\" : Enable SoftAP auto dhcp start"
	default n

endif # AT
```

## lib/ble/Kconfig
```kconfig
menuconfig BLE
	bool "BLE library"
	default y
	select PTA
	help
	 Enable BLE library

if BLE

config BLE_TELINK
	bool
    default n
	help
	  Enable Link Layer model for TELINK BLE.

config BLE_NIMBLE_CTRL
	bool
    default y
	select SYSTIMER
	select TINYCRYPT
	select PTA
	select HW_CRYPTO
	help
	  Enable NIMBLE BLE controller

if BLE_NIMBLE_CTRL

config BLE_CLI_DTM
	bool "Enable BLE DTM from CLI"
	default n

config BLE_CLI_CW
	bool "Enable BLE continuous wave from CLI"
	default n

config DEFAULT_BLE_MACADDR
	string "BLE device address"
	default "01:02:03:04:05:06"

choice BLE_NIMBLE_HCI_TRANSPORT
	prompt "HCI interface"
	default BLE_NIMBLE_HCI_TRANSPORT_UART

config BLE_NIMBLE_HCI_TRANSPORT_SCM2010_IPC
	bool "Bluetooth HCI IPC"

config BLE_NIMBLE_HCI_TRANSPORT_UART
	bool "Bluetooth HCI UART"

config BLE_NIMBLE_HCI_TRANSPORT_NATIVE
	bool "Bluetooth HCI NATIVE"

endchoice

if BLE_NIMBLE_HCI_TRANSPORT_UART

config BLE_NIMBLE_HCI_TRANSPORT_UART_PORT
	int "HCI UART port"
	default 1

config BLE_NIMBLE_HCI_TRANSPORT_UART_BAUDRATE
	int "HCI UART baudrate"
	default 115200

endif

config BLE_STATICS
    bool
    default n

config BLE_SCA
    int
    default 2500

config BLE_ADV_DISABLE_RND_DELAY
    bool
    default n

endif

config BLE_NIMBLE_HOST
	bool "BLE Host"
	depends on BLE_NIMBLE_HCI_TRANSPORT_NATIVE
	default y
	help
	 Enable BLE host stack

endif
```

## lib/cli/Kconfig
```kconfig
menuconfig DEBUG_MODE
bool "Enable WISE debug configurations"
	select CMDLINE
	select IFCONFIG if LWIP && NET80211
	select IFCONFIG_WIRELESS if LWIP && NET80211
	default n
	help
	 Enable WISE debug configurations.

menuconfig CMDLINE
	bool "Command line interface"
	default y
	help
	 Enable WISE command line interface.

if CMDLINE

config CMDLINE_PROMPT
	string "Command line prompt"
	default "$ "
	help
	 Command line interface prompt

config CMDLINE_MAX_LEN
	int "Command line max. length"
	default 256

config CLI_HISTORY
    bool "Command history"
    default y
    help
     Enable command history

config CLI_MAX_HISTORY
    int "Number of history entries" if CLI_HISTORY
    default 8

config CLI_AUTOCOMPLETE
    bool "Command auto completion"
    default n

config CLI_EXT
    bool "Enable CLI extension framework"
    default y

config CLI_STAYTIMEOUT
    int "Enable CLI stay active" if PM_SCM2010
    default 3000
     help
      If there is CLI input after wakeup, stay active for n ms so that CLI can work

menuconfig CMD_UTIL_PROC
	bool "Proc utilities"
	default y
	select USE_TRACE_FACILITY
	help
	 Process (task) commands

if CMD_UTIL_PROC
config CMD_TOP
	bool "top"
	default y

config CMD_PS
	bool "ps"
	default y

config CMD_SUSPEND
	bool "suspend"
	default n

config CMD_RESUME
	bool "resume"
	default n

config CMD_KILL
	bool "kill"
	default n

config CMD_IRQ
	bool "irq"
	default y

endif # CMD_PROC

menuconfig CMD_UTIL_FILE
	bool "File utilities"
	default n

if CMD_UTIL_FILE
source "lib/fs/Kconfig"
endif

menuconfig CMD_UTIL_NET
	depends on NET
	bool "Networking utilities"
	default y

if CMD_UTIL_NET

source lib/ifconfig/Kconfig
#config CMD_IFCONFIG
#	bool "ifconfig"
#	select LIBIFCONFIG
#	default y

config CMD_PING
	bool "ping"
	depends on LWIP
	default y

config CMD_DHCLIENT
	bool "dhclient"
	depends on LWIP_DHCP
	default n
	help
	 dhclient is an LWIP Dynamic Host Configuration Protocol client
	 command

config CMD_DHCPS
	bool "dhcps"
	depends on LWIP_DHCPS
	default y
	help
	 dhcps is an LWIP Dynamic Host Configuration Protocol server
	 command

config CMD_MDNS
	bool "mdns"
	depends on LWIP_MDNS_RESPONDER
	default n
	help
	 mdns is an LWIP Multicase DNS command

config CMD_SNTP
	bool "sntp"
	depends on LWIP_SNTP
	default n
	help
	 mdns is an LWIP simple NTP

config CMD_IPERF
	bool "iperf3"
	depends on LWIP
	default y
	help
	 iperf3 based client and server

config CMD_NET
	bool "net"
	depends on LWIP
	default y

config CMD_NETTOOL
	bool "net tool"
	depends on LWIP
	depends on N22_ONLY
	default n

config CMD_WSHARK
	bool "wshark"
	depends on LWIP
	depends on NET80211
	depends on WPA_SUPPLICANT
	default n
	help
	 frame monitor


#source "lib/hostap/wpa_supplicant/Kconfig"

endif # CMD_UTIL_NET

menuconfig CMD_UTIL_MISC
	bool "Miscellaneous utilities"
	default y

if CMD_UTIL_MISC

config CMD_HELP
	bool "help"
	default y

config CMD_VERSION
	bool "version"
	default y

config CMD_DMESG
	bool "dmesg"
	default y

config CMD_MEM
	bool "hexdump/read/write command"
	default y

config CMD_HEAP
	bool "heap command"
	default y

config CMD_FLASH
	bool "flash command"
	default n
	select SPI_FLASH
    select XYZMODEM

config CMD_LOADB
	bool "load{xy} command"
	default n
	select SPI_FLASH
    select XYZMODEM

config CMD_RTC
	bool "rtc command"
	default n

config CMD_USB
	bool "usb command"
	default n

config CMD_EFUSE
	bool "eFuse command"
	depends on EFUSE
	default n

config CMD_SDIO
    bool "SDIO command"
    default n

config CMD_I2C_TEST
    bool "I2C command"
    default n
    depends on TEST_PERIPHERAL

config CMD_JUMP
	bool "Jump to an address"
	default n

config CMD_REBOOT
    bool "Reboot the system"
	default y
	depends on WDT
	depends on WISE_API

config CMD_RESET
	bool "Reset the system"
	default n
	help
	 Lightweight SW reset w/o Boot ROM or bootloader

config CMD_PMU
	bool "PMU command"
	default n

config CMD_RTC_PIT_SNAP
	bool "SNAP command"
	default n

config CMD_PTA
	bool "PTA command"
	default n

endif

config CMD_AT
	bool "at" if AT
	default n
	help
	 at is the command entering AT mode

endif # CMDLINE
```

## lib/crypto/Kconfig
```kconfig
menu "crypto"

config LIB_CRYPTO
	bool
	default y
	help
	Say y to add cryptographic libraries such as rijndael (AES)

endmenu
```

## lib/fs/Kconfig
```kconfig
config CMD_CAT
	bool "cat"
	default y

config CMD_CP
	bool "cp"
	default y

config CMD_LS
	bool "ls"
	default y

config CMD_MV
	bool "mv"
	default y

config CMD_RM
	bool "rm"
	default y
```

## lib/fs/spiffs/Kconfig
```kconfig
menuconfig SPIFFS
	bool "Support SPIFFS (SPI Flash File System)"
	depends on SPI_FLASH
	default y
	help
	 Include SPIFFS

if SPIFFS

config SPIFFS_NUM_OPEN_FILES
	int "SPIFFS maximum # of open files"
	default 10
	help
	One spiffs open file occupies 64 byte of the heap


config SPIFFS_NUM_CACHE_PAGES
       int "SPIFFS # of cache pages"
       default 4

config SPIFFS_OBJ_NAME_LEN
	int "SPIFFS maximum length of object's name"
	default 64
	help
	Maximum length of name that a spiffs object can have

config SPIFFS_SYSTEM_PART_ADDR
	hex "System partition address"
	default 0x80380000

config SPIFFS_SYSTEM_PART_SIZE
	hex "System partition size"
	default 0x80000

endif
```
