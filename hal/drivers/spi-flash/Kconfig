## hal/drivers/spi-flash/Kconfig
```kconfig
#
# SPI flash driver and memory configuration
#

menu "SPI flash drivers"

config SPI_FLASH
	bool "Enable SPI flash driver framework"
	help
	   Enable driver model for SPI flash.

if SPI_FLASH

comment "SPI flash controller"

config SPI_FLASH_CONTROLLER_ADC
	bool "ADChip's SPI flash controller driver"
	depends on SPI_FLASH

config SPI_FLASH_CONTROLLER_SANDBOX
       bool "Sandbox SPI flash controller driver"
       depends on SPI_FLASH && SANDBOX

config ATCSPI200
	bool "AndeShape (tm) ATCSPI200 driver"

if ATCSPI200

config ATCSPI200_COMPACT
    bool "ATCSPI200 small size compact driver"
    default y

config ATCSPI_SCLK_HZ
	int "ATCSPI SCLK frequency"
	default 60000000
endif

config FLASH_DEFAULT_MAP
	bool "Use a default map for a new flash device"
	default y

config FLASH_DEBUG_VERBOSITY
	int "Control verbosity of spi-flash driver"
	default 1
	help
	  0 : no debug
	  1 : error only
	  2 : fully verbose

comment "SPI flash memory"

config SPI_FLASH_ATMEL
	bool "Atmel SPI flash support"
	help
	  Add support for various Atmel SPI flash chips (AT45xxx and AT25xxx)

config SPI_FLASH_EON
	bool "EON SPI flash support"
	help
	  Add support for various EON SPI flash chips (EN25xxx)

config SPI_FLASH_GIGADEVICE
	bool "GigaDevice SPI flash support"
	help
	  Add support for various GigaDevice SPI flash chips (GD25xxx)

 config SPI_FLASH_GIANTEC
    bool "Giantec SPI flash support"
    help
	  Add support for various Giantec SPI flash chips (GT25xxx)

config SPI_FLASH_MACRONIX
	bool "Macronix SPI flash support"
	help
	  Add support for various Macronix SPI flash chips (MX25Lxxx)

config SPI_FLASH_SPANSION
	bool "Spansion SPI flash support"
	help
	  Add support for various Spansion SPI flash chips (S25FLxxx)

config SPI_FLASH_STMICRO
	bool "STMicro SPI flash support"
	help
	  Add support for various STMicro SPI flash chips (M25Pxxx and N25Qxxx)

config SPI_FLASH_SST
	bool "Microchip SST SPI flash support"
	help
	  Add support for various SST SPI flash chips (SST25xxx and SST26xxx)

config SPI_FLASH_WINBOND
	bool "Winbond SPI flash support"
	help
	  Add support for various Winbond SPI flash chips (W25xxx)

config SPI_FLASH_XTX
	bool "XTX SPI flash support"
	help
	  Add support for various XTX SPI flash chips (xt25xxx)

config SPI_FLASH_PUYA
	bool "Puya SPI flash support"
	help
	  Add support for various Puya SPI flash chips (P25Qxxxx)

config SPI_FLASH_ZBIT
	bool "ZBIT SPI flash support"
	help
	  Add support for various ZBIT SPI flash chips (ZB25xxxx)

config SPI_FLASH_XMC
	bool "XMC SPI flash support"
	help
	  Add support for various XMC SPI flash chips (XMCxxxx)


endif

endmenu # menu "SPI Flash Support"
```

## hal/drivers/spi/Kconfig
```kconfig
menu "SPI Support"

config SPI
	bool "Enable SPI driver framework"
    default n
	depends on USE_SPI0 || USE_SPI1 || USE_SPI2
    select DMA
	help
      Enable SPI driver framework.

if SPI

config SPI_ATCSPI
	bool "AndesTech AndeShape SPI support"
	default y if SOC_SCM2010

if SPI_ATCSPI
config SPI_SUPPORT_MULTI_SLAVES_AS_A_MASTER
	bool "Support multi slaves operation as a master(EXPERIMENTAL)"
	default n
	help
	  Enable configuration of multiple GPIO pins to be used as chip-selects for multiple slaves.

config SPI_SUPPORT_MULTI_SLAVES_AS_A_SLAVE
	bool "Support multi slaves operation as a slave(EXPERIMENTAL)"
	default n
	help
	  Release MISO pin to allow other slaves to work alongside. Make sure the master will insert enough DUMMY cycles after sending a slave command.
endif

config SPI_CONTROL_MISO_FROM_ILM
    bool "Run MISO control routines from ILM"
    default n
    depends on SPI_SUPPORT_MULTI_SLAVES_AS_A_SLAVE
    depends on SOC_SCM2010

endif

endmenu
```

## hal/drivers/systimer/Kconfig
```kconfig
menu "SYSTIMER Support"

config SYSTIMER
	bool "System Specific Timer"
    default y
	help
	  Implementation dependent system specific timer 

if SYSTIMER

config SYSTIMER_SCM2010

	bool "SCM2010 SYSTIMER support"
	default y

endif

endmenu
```

## hal/drivers/timer/Kconfig
```kconfig
menu "Timer Support"

config TIMER
	bool "Enable timer driver framework"
	help
	  Enable driver model for timer access. It uses the same API as
	  lib/time.c, but now implemented by the uclass. The first timer
	  will be used. The timer is usually a 32 bits free-running up
	  counter. There may be no real tick, and no timer interrupt.

if TIMER

config WALL_TIMER
	bool "Use timer device for a wall timer"
	default n

if WALL_TIMER

config WALL_TIMER_ID
	int "ID of the timer to use as a wall timer"
	default 0

endif

config TIMER_SCM2020
	bool "Senscomm SCM2020 timer support" if TIMER
	default y if SOC_SCM2020

config TIMER_ATCPIT
	bool "AndesTech AndeShape ATCPIT timer support" if TIMER
	depends on USE_TIMER0 || USE_TIMER1
	default y if SOC_TS8266
	default y if SOC_SCM1010
	default y if SOC_SCM2010

config TIMER_SP804
	bool "ARM SP804 timer support" if TIMER
	default y if SOC_BCM2836

config TIMER_SANDBOX
	bool "Sandbox timer support"
	depends on SOC_SANDBOX

endif

endmenu
```

## hal/drivers/watchdog/Kconfig
```kconfig
menu "Watchdog Timer Support"

config WDT
	bool "Enable watchdog timer driver framework"
	help
	  Enable driver model for wdt. 

config WDT_ATCWDT
	bool "AndesTech AndeShape ATCWDT support" if WDT
	default y

if WDT_ATCWDT

config ATCWDT200_32BIT_TIMER
	bool "32-bit watchdog interrupt timer"
	default n

endif

endmenu
```

## hal/drivers/wlan/Kconfig
```kconfig
#
# WLAN (802.11) driver
#

if WLAN
menu "WLAN (802.11) drivers"

source "hal/drivers/wlan/senscomm/Kconfig"

endmenu # menu "WLAN (802.11) drivers"

endif
```

## hal/drivers/wlan/senscomm/Kconfig
```kconfig
#
# Senscomm WLAN driver
#
#
config WLAN_SENSCOMM
    bool
    default y
    select PTA

config SENSCOMM_WLAN_2020
	bool
    default y
	select SUPPORT_AMPDU_TX
	select SUPPORT_AMPDU_RX

if SENSCOMM_WLAN_2020

config WLAN_HW_SCM2010
	bool
	default y

comment "Configuration"

config RX_BUF_NUM_LOG2
    int "log2(num of rx buffers)"
    default 5
    help
    1: 2 buffers, 2: 4 buffers, ... 8: 256 buffers

config MAX_AMSDU_NUM
	int "Maximum number of subframes that can be aggregated into an A-MSDU at one time."
	default 2
	range 1 4
	help
	Maximum of two subframes can be aggregated into an A-MSDU at one time.

config TX_BUF_RESERVED_NUM
	int "reserved for tx"
	default 16
	help
	It's depend on RX_BUF_NUM_LOG2 and CONFIG_MEMP_NUM_MBUF_CACHE settings

config BDS_HDR_NUM
	int
	default 2

config SUPPORT_BDS_ADJ
	bool
	default n

config MONITOR_BEACON_MISS
	bool "Monitor beacon misses"
	default y
	help
	Enable beacon misses for a STA mode

if MONITOR_BEACON_MISS

config BMISS_THRESHOLD
    int "Default Beacon miss check window"
    default 15
    help
    Define a window in which Beacon miss will be monitored, in unit of Beacon interval.

config BMISS_DYN_WIN
    bool "Enable dynamic adjustment of BMISS window"
    default y
    help
    Adjust BMISS window dynamically based on BMISS rate

endif

config AP_PROXIMATE_THR
	int "AP's RSSI threshold to be determined as being proximate"
	default -30
	help
	If the average RSSI of Beacon frames are higher than this value, it is regarded as being proximate.

config AP_PROXIMATE_TXPWR
	int "HW controlled Tx power (dBm) when AP's proximate"
	default 10
	help
	If the AP is determined to be proximate, HW generated frames will be sent with this power.

config ENABLE_TX_TO
	bool "Enable Tx timeout mechanism"
	default y

config ENABLE_RX_TO
	bool "Enable Rx timeout mechanism"
	default y

config ERRATA_TX_TIMING_GAP
	bool "Enable Errata timing gap"
	default y

config SUPPORT_HE_RX_MCS_8_9
	int "support Rx MCS 8, 9"
	default 0
	help
	0: MCS 0-7, 1: 0-9, 2: 0-11

config USE_SYSDMA_FOR_MACFW_DN
	bool "Use DMA engine for IMEM loading"
	default y

config SUPPORT_TX_KEEPALIVE
   bool "Enable TX Null for Keepalive"
   default n

if SUPPORT_TX_KEEPALIVE
config TX_KEEPALIVE_INTERVAL
   int "Null keep-alive interval time(s)"
   default 20
   range 1 240
endif

#comment "Debugging features"

if CMDLINE
config SCM2020_CLI_MAC
	bool
	default y
	help
	Say Y to enable 'mac' command
endif

comment "Power management"

config SCM2020_WLAN_PM
	bool "Enable WLAN Power Management"
    depends on PM_SCM2010
	default y
endif

if SCM2020_WLAN_PM
	config NO_BEAMFORMEE_FOR_PS
	bool "Prevent AP from sending NDPA when in sleep mode"
	default n
endif
```

## hal/fs/Kconfig
```kconfig
menu "VFS support"

config VFS_MAX_FDS
       int "Maximum number of open files"
       range 16 32
       default 32

source "lib/fs/spiffs/Kconfig"

endmenu
```

## hal/soc/Kconfig
```kconfig
choice
	prompt "System-On-A-Chip select"
	default SOC_SCM2010

config SOC_SCM2010
	bool "Senscomm SCM2010 SoC"
	select NDSV5
    select DEVICE_REGION
    select ICACHE_ENABLE
    select DCACHE_ENABLE if BOOTLOADER
    select PM_DM if !BOOTLOADER && !BOOTROM
    select CLK_SCM2010 if !BOOTROM

endchoice

source "hal/soc/scm2010/Kconfig"
```

## hal/soc/scm2010/Kconfig
```kconfig
if SOC_SCM2010

config SYS_SOC
	default "scm2010"

menu "Build configuration"

config LINK_TO_ROM
    bool "Build a regular wise that is linked to symbols in ROM"
    default y

if LINK_TO_ROM

config LINK_TO_ROM_VER_MAJOR
    int
    default 1

config LINK_TO_ROM_VER_MINOR
    int
    default 1

config ROM_LDSCRIPT
    string "Specify a ROM linker script"
    default "hal/soc/scm2010/wise.rom_v2.ld"

endif

config IMAGE_VER_MAJOR
    int "Image version major number"
    default 0

config IMAGE_VER_MINOR
    int "Image version minor number"
    default 1

config XIP
    bool "Build a flash binary, wise.bin"
    default y

config FLASH_BASE_OFFSET
    hex
    default 0x80000000

config FLASH_IMAGE_OFFSET
    hex "Flash image offset"
    default 0x80080000

config FLASH_IMAGE_SIZE
    hex "Flash image size"
    default 0x180000

config SCMBOOT_SECURE
    bool "Add secure scmboot signature"
    default n

if XIP

config SYNC_FLASH_ACCESS
    bool "Enable synchronization mechanism of flash access"
    default n

if SYNC_FLASH_ACCESS

config SYNC_RX_IRQ
    int "PLIC interrupt source for incoming sync signal"
    default 49

config SYNC_TX_IRQ
    int "PLIC interrupt source for outgoing sync signal"
    default 50

endif

config FLASH_ENCRYPTION
    bool "Flash encryption (create encrypted binary)"
    default n

endif

config SYS_LDSCRIPT
    string "Specify a linker script"
    default "hal/soc/scm2010/wise.xip.lds"


config HOSTBOOT
    bool "Build binary files for host boot"
    default n

if HOSTBOOT

config MULTI_BINS
	bool "Support multiple binaries to be loaded into different regions"
	default n

endif

config N22_ONLY
	bool "Enable only N22"
	default y
	help
	  Choose y to enable only N22 and utilize D25 local memories as system memory

config MCUBOOT_OTA
	bool "Enable OTA"
	depends on N22_ONLY

config MCUBOOT_OTA_SECURE
	bool "Add secure mcuboot signature"
	depends on MCUBOOT_OTA

endmenu

menu "Power management"

config PM_SCM2010
	bool "Enable SCM2010 PM"
	depends on PM_DM
    depends on SOC_SCM2010
    default y

if PM_SCM2010

config PM_HIBERNATION_PARTITION_ADDR
	hex "Hibernation partition address"
	default 0x80018000

config PM_HIBERNATION_LIMIT_DURATION
    int "Hibernation limit count clear duration (sec)"
    default 86400

config PM_HIBERNATION_LIMIT_MAX
    int "Hibernation limit count"
    default 27

config PM_HIBERNATION_VERIFY
    bool "Hibernation content verify"
    default y

config PM_RTC_RATIO_INVALID_TIME
    int "Calculated RTC ratio valid time (s)"
    default 10

config SUPPORT_PMP_CMD
    bool "set pmp to update pm features by cli command"
    default y

config PM_CMD_RTC_CAL
    bool "set RTC calibration period by cli command"
    default n

config SCM2010_PM_WIFI_AUTO_RUN
    bool "Enable SCM2010 PM Enter automatically after connection"
    default y

config SCM2010_PM_HOLE_PUNCH
    bool "Enable SCM2010 PM TCP/UDP Hole punch function"
    default n

config PM_TEST
    bool
    default n

menu "Power management feature"

config PM_VOLTAGE_CTRL
	bool "PM voltage control"
	default y
	help
     Regulator voltage down when enter lowpower mode.

config PM_AON_VOLTAGE_CTRL_OCR
	bool "PM AON voltage switch by OCR"
	default y
	help
	 Always ON domain voltage switch by OCR mode.

config PM_AON_VOLTAGE_CTRL
	bool "PM AON voltage control"
	default n
	depends on !PM_AON_VOLTAGE_CTRL_OCR
	help
	 Always ON domain voltage down when enter lowpower mode.

config PM_PLL_CTRL
	bool "PM PLL control"
	default y
	help
	 PLL turn off when enter lowpower mode.

config PM_LOWPOWER_IO_OFF
	bool "PM IO LDO off sleep"
	default y
	help
	 IO LDO turn off in lowpower mode.

config PM_WAKEUP_IO_OFF
	bool "PM IO LDO off wakeup"
	default n
	help
	 Wakeup with IO LDO off.

config PM_WAKEUP_LOG_ON
	bool "PM wakeup log on"
	default n
	depends on !PM_WAKEUP_IO_OFF
	help
	 Wakeup with log on.

config PM_FLASH_DPD
	bool "PM FLASH deep powerdown"
	default y
	help
	 Flash enter deep power down mode.

config PM_WC_LOG
	bool "PM log in watcher"
	default y
	help
	 Enable PM LOG in watcher.

config PM_WC_UART1
	bool "PM log use UART1 in watcher"
	default n
	help
	 Enable Use UART1 for PM log in watcher. If not set, use UART0.

config PM_AON_GPIO_CTRL
	bool "PM AON GPIO control"
	default y
	help
	 AON GPIO not set by the user are converted to input when enter lowpower mode.

config PM_RFC_LP_BYS
	bool "PM RFC LP bypass"
	default y
	help
	 RFC lowpower mode bypass.

config PM_DLDO_DCDC_CTRL
	bool "PM Capless LDO/DCDC control"
	default y
	help
	 PM Capless LDO and DCDC control.

config PM_GPIO_DBG
	bool "PM GPIO DBG"
	default n

endmenu

endif

endmenu

menu "Device configuration"

menu "Clock configuration"

config USE_DEFAULT_CLK
	bool
	default n

config SUPPORT_CORE_240MHZ
	bool "Enable 240MHz for cores (EXPERIMENTAL)"
	default n
	depends on !USE_DEFAULT_CLK && N22_ONLY

endmenu

menu "UART configuration"

config USE_UART0
	bool "Enable UART0"
	default y

config USE_UART1
	bool "Enable UART1"
	default y

config USE_UART2
	bool "Enable UART2"
	default n

endmenu

menu "TIMER configuration"

config USE_TIMER0
	bool "Enable TIMER0"
	default n

config USE_TIMER0_PWM
	bool "Enable PWM mode of TIMER0"
	default y
	depends on USE_TIMER0

config USE_TIMER1
	bool "Enable TIMER1"
	default n

config USE_TIMER1_PWM
	bool "Enable PWM mode of TIMER1"
	default y
	depends on USE_TIMER1

endmenu

menu "SPI configuration"

config USE_SPI0
	bool "Enable SPI0 (QSPI)"
	default y

config USE_SPI0_FLASH
    bool "Support SPI Flash on SPI0"
    default y
    depends on USE_SPI0

config USE_SPI1
	bool "Enable SPI1"
	default n

config USE_SPI1_FLASH
    bool "Support SPI Flash on SPI1"
    default n
    depends on USE_SPI1

config USE_SPI2
	bool "Enable SPI2"
	default n

config USE_SPI2_FLASH
    bool "Support SPI Flash on SPI2"
    default n
    depends on USE_SPI2

config SPIFFS_ON_SPI2
    bool "Mount SPIFFS on SPI2"
    default n
    depends on USE_SPI2_FLASH

endmenu

menu "I2C configuration"

config USE_I2C0
	bool "Enable I2C0"
	default n

config USE_I2C1
	bool "Enable I2C1"
	default n

config USE_I2C_GPIO
	bool "Enable I2C GPIO"
	default n

if USE_I2C_GPIO

config I2C_GPIO_PIN_SCL
	int "GPIO pin number for I2C SCL"
	default 23

config I2C_GPIO_PIN_SDA
	int "GPIO pin number for I2C SDA"
	default 24

endif

endmenu

menu "I2S configuration"

config USE_I2S
	bool "Enable I2S"
	default n

endmenu

menu "ADC configuration"

config USE_AUXADC
	bool "Enable AUXADC"
	default n

endmenu

endmenu

endif
```
