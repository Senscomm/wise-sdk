## kernel/FreeRTOS/Kconfig
```kconfig
menu "FreeRTOS kernel"

config FREERTOS
        bool
	default y

if FREERTOS

config FREERTOS_ASSERT_VERBOSITY
	int
	default 2
	help
	0 = configASSERT() is empty
	1 = configASSERT() causes the kernel crash
	2 = configASSERT() prints file, line, function, and then causes the crash

config FREERTOS_VERSION
	string
	default "10.2.1"

config PORT_NEWLIB
	bool
	default n
	select USE_NEWLIB_REENTRANT
    select HEAP_AUTO_SIZE
	help
	 Include newlib ports implemented on FreeRTOS so that application can fully
	 utilize POSIX APIs including dynamic memory primitives such as malloc, free.

menu "Task options"

config DEFAULT_STACK_SIZE
	int
	default 4096
        help
	 This specifies the stack size (in bytes) of the idle
	 task. The tasks created by osThreadNew() also have the stack
	 of this size if the stack size is not specified in attribute
	 parameter.

config MAX_PRIORITIES
       int
       default 8
       help
         Task has the priority in [0..MAX_PRIORITY-1] range.

config DEFAULT_TASK_PRIORITY
       int
       range 0 MAX_PRIORITIES
       default 0

config MAX_TASK_NAME_LEN
       int
       default 32

config IDLE_TASK_NAME
       string
       default "idle"

config USE_PREEMPTION
       bool
       default y

if USE_PREEMPTION
config USE_TIME_SLICING
       bool
       default y
       help
        If y, FreeRTOS uses prioritized preemptive scheduling with
        time slicing. That means the RTOS scheduler will always run
        the highest priority task that is in the Ready state, and will
        switch between tasks of equal priority on every RTOS tick
        interrupt. If n, then the RTOS scheduler will still run the
        highest priority task that is in the Ready state, but will not
        switch between tasks of equal priority just because a tick
        interrupt executed.

config IDLE_SHOULD_YIELD
       bool
       default y
       help
        configIDLE_SHOULD_YIELD controls the behavior of the idle task
        if there are application tasks that also run at the idle
        priority. It only has an effect if the preemptive scheduler is
        being used.

endif

config USE_PORT_OPTIMISED_TASK_SELECTION
       bool
       default n
       help
        Say Y if you want to use task selection algorithm provided by
        your port.

config USE_NEWLIB_REENTRANT
       bool
       default n


config USE_DAEMON_TASK_STARTUP_HOOK
       bool
       default n
       help
        Say y to add a hook before the timer task starts. The hook
        function prototype is void
        vApplicationDaemonTaskStartupHook(void). If unsure, say N.

config USE_TASK_FPU_SUPPORT
       int
       default 1

config USE_IDLE_HOOK
       bool
       default n
       help
        Say y to have the idle task call to custom
        'void vApplicationIdleeHook(void)' function in its ilde loop.

config GENERATE_RUN_TIME_STATS
       bool
       default y
       help
        The task run time statistics feature collects information on
        the amount of processing time each task is receiving. The
        feature requires the application to configure a run time
        statistics time base. The frequency of the run time statistics
        time base must be at least ten times greater than the
        frequency of the tick interrupt. Setting
        configGENERATE_RUN_TIME_STATS to 1 will include the run time
        statistics gathering functionality and associated API in the
        build. Setting configGENERATE_RUN_TIME_STATS to 0 will
        exclude the run time statistics gathering functionality and
        associated API from the build. If
        configGENERATE_RUN_TIME_STATS is set to 1, then the
        application must also provide definitions for the macros
        described in Table 2. If configGENERATE_RUN_TIME_STATS is set
        to 0 then the application must not define any of the macros
        described in Table 2, otherwise there is a risk that the
        application will not compiler and/or link.

config USE_TRACE_FACILITY
       #Wise mandate this to be set to Y
       #bool "Support task trace feature"
       bool
       default y
       select GENERATE_RUN_TIME_STATS
       help
        Say Y to support additional structure members and functions
        that assist with execution visualization and tracing being
        included in the build.

config USE_TASK_NOTIFICATIONS
       bool
       default y
       help
        Setting configUSE_TASK_NOTIFICATIONS to 1 (or leaving
        configUSE_TASK_NOTIFICATIONS undefined) will include direct to
        task notification functionality and its associated API in the
        build. Setting configUSE_TASK_NOTIFICATIONS to 0 will exclude
        direct to task notification functionality and its associated
        API from the build. Each task consumes 8 additional bytes of
        RAM when direct to task notifications are included in the
        build.

config USE_APPLICATION_TASK_TAG
       bool
       default n

config NUM_THREAD_LOCAL_STORAGE_POINTERS
       int
       default 2
       help
        Number of TLS pointers to use, 0 means disabled.

config USE_STATS_FORMATTING_FUNCTIONS
       bool
       select USE_TRACE_FACILITY
       default n
       help
        Say y to include the vTaskList() and
        vTaskGetRunTimeStats(). functions in the build, which visualize
        the snapshot of task eecution. Say N if unsure (WISE has its
        own implementation)

config INCLUDE_eTaskGetState
	bool
	default y

config INCLUDE_uxTaskGetStackHighWaterMark
	bool
	default y

config INCLUDE_uxTaskPriorityGet
	bool
	default y

config INCLUDE_vTaskDelay
	bool
	default y

config INCLUDE_vTaskDelayUntil
	bool
	default y

config INCLUDE_vTaskDelete
	bool
	default y

config INCLUDE_vTaskPrioritySet
	bool
	default y

config INCLUDE_vTaskSuspend
	bool
	default y

config INCLUDE_xTaskAbortDelay
	bool
	default y

config INCLUDE_xTaskGetCurrentTaskHandle
	bool
	default y

config INCLUDE_xTaskGetHandle
	bool
	default y

config INCLUDE_xTaskGetIdleTaskHandle
	bool
	default y

config INCLUDE_xTaskGetSchedulerState
	bool
	default y

config INCLUDE_xTaskResumeFromISR
	bool
	default y

endmenu


menu "Synchronization primitives"

config USE_MUTEXES
       bool
       default y

config USE_RECURSIVE_MUTEXES
	bool
	depends on USE_MUTEXES
	default y

config USE_COUNTING_SEMAPHORES
       bool
       default y

config USE_QUEUE_SETS
       bool
       default y

config INCLUDE_xQueueGetMutexHolder
	bool
	default y

config INCLUDE_xSemaphoreGetMutexHolder
	bool
	default y

config USE_POSIX_ERRNO
	bool
	default y

endmenu


menu "Tick, clock and timer options"

config TICK_RATE_HZ
       int
       default 1000

config USE_TICK_HOOK
       bool
       default n
       help
        Say y if you want your 'void vApplicationTickHook(void)'
        function to be called by system tick handler.

config USE_16_BIT_TICKS
       bool
       default n

config USE_TICKLESS_IDLE
       int
       default 1
       help
        ?

config TIMER_HZ
	int
	default 1000000

config XTAL_CLOCK_HZ
       int
       default 40000000

config USE_TIMERS
       bool
       default y

if USE_TIMERS
config TIMER_SERVICE_TASK_NAME
       string
       default "ksofttimerd"

config TIMER_TASK_PRIORITY
       int
       default 5

config TIMER_TASK_STACK_SIZE
       int
       default 2048

config TIMER_QUEUE_LENGTH
       int
       default 32

config INCLUDE_xTimerPendFunctionCall
	bool
	default y

endif

endmenu

menu "Memory option"

config HEAP_AUTO_SIZE
       bool
       default y
       help
        Say Y to let the linker decide the heap region to be used in
        each memory.

if !HEAP_AUTO_SIZE
config HEAP1_SIZE
	int
	default 0

config HEAP2_SIZE
	int
	default 0

config HEAP3_SIZE
	int
	default 0
endif

if !PORT_NEWLIB

config SUPPORT_DMA_DYNAMIC_ALLOC
    bool "Enable DMA dynamic allocation"
	default y
    select MEM_HEAP_EXT

config USE_MALLOC_DEBUG
    bool "Debug enabled malloc/free"
    default n
    select MEM_HEAP_EXT
    help
     Track allocated memory and detect orphaned ones as well as
     overflows.

if USE_MALLOC_DEBUG

config SIZE_ALLOC_LIST
    int "Number of tracked alloc list"
    default 1024

config MEM_HEAP_DEBUG
	bool "Record memory allocated function"
#	depends on !LINK_TO_ROM
	default n

if MEM_HEAP_DEBUG

config MEM_HEAP_DEBUG_FUNCNAMELEN
	int "Function Name Length"
	depends on MEM_HEAP_DEBUG
	default 16
	help
	 Length of Function name to be printed

endif

config MEM_HEAP_PERIOD_TIME_DEBUG
    bool "Record memory max usage in a period of time"
	default n

endif
endif

config MEM_HEAP_EXT
    bool
    default y

config CHECK_FOR_STACK_OVERFLOW
       int
       default 0

config RECORD_STACK_HIGH_ADDRESS
       int
       default 1

config SUPPORT_DYNAMIC_ALLOCATION
       bool
       default y

config SUPPORT_STATIC_ALLOCATION
       bool
       default y

endmenu

if ARM && ARM_CORTEX_A7

menu "ARMv7-A port"

config FPU_D32
	int
	default 0

config INTERRUPT_CONTROLLER_BASE_ADDRESS
	hex
	default 0x0
	help
	  Must be set to the base address of the ARM Generic Interrupt Controller

config INTERRUPT_CONTROLLER_CPU_INTERFACE_OFFSET
	hex
	default 0x0
	help
	  The offset from configINTERRUPT_CONTROLLER_BASE_ADDRESS at which the GIC's CPU interface starts.

config UNIQUE_INTERRUPT_PRIORITIES
	int
	default 0
	help
	  The number of unique priorities that can be specified in the GIC

config MAX_API_CALL_INTERRUPT_PRIORITY
	int
	default 0
	help
	  Interrupts assigned a priority at or below this priority can call interrupt safe FreeRTOS
	  API function, and will nest.

endmenu

endif

if NDSV5

menu "NDSV5 (RISC-V) port"

config MTIME_BASE_ADDRESS
	hex
	default 0xE6000000
	help
	  Must be set to the base address of the Machine Timer (NCEPLMT100)

config MTIME_CLK_DIV
    int
    default 4
    help
      mtime_clk_div = cpu_clk / mtime_clk

config CLINT_BASE_ADDRESS
	hex
	default 0x0

endmenu

endif

#
# Other options
#

config USE_LIST_DATA_INTEGRITY_CHECK_BYTES
       int
       default 0

config USE_CO_ROUTINES
       bool
       default n


config USE_ALTERNATIVE_API
       bool
       default n

config FREERTOS_INDIRECT_PORT_FUNCTION
	bool
	default n
	default n
	help
 	 In case FreeRTOS port layer functions (*Port*()) should not
 	 be called directly from FreeRTOS kernel core for some reason
 	 (e.g. kernel core is ROMized), include this ile after defining
 	 FREERTOS_PORT macro in port.c file.

 	 This will rename port function, and register a function table
	 structure via freertos_register_port() call, and makes the
 	 port function call indirect via this table.

	 Different ports define different port function, so this is not
 	 a very general solution yet. Currently, only Andes D10 port
 	 has been implemented and tested.
endif

config USE_T32
	bool
	default n

config USE_QUEUE_POOL
    bool
    default y

config QUEUE_POOL_SIZE
    int
    default 120
	depends on USE_QUEUE_POOL

config USE_TIMER_POOL
    bool
    default y

config TIMER_POOL_SIZE
    int
    default 32
	depends on USE_TIMER_POOL

endmenu
```

## kernel/Kconfig
```kconfig
source kernel/FreeRTOS/Kconfig
source kernel/cmsis-freertos/Kconfig
source kernel/freebsd/Kconfig

menu "General setup"

config PRINTK_BUF_LEN
	int "printk buffer size"
	default 4096

config BACKTRACE
	bool "Backtrace on kernel panic (EXPERIMENTAL)"
	default n

config NV_LOG
    bool "Kernel logging to retention memory"
    default n

config DEFAULT_ASSERT_VERBOSITY
    int "Default Assert verbosity"
    default 2

config SUPPORT_MTSMP
	bool "Record mbuf timestamp"
    default n

config SUPPORT_MEM_SLAB
	bool "Enable slab memory"
    default y

config SUPPORT_VQUEUE
	bool "Enable vqueue"
    default y

config ILM_O1
	bool "O1 for ilm"
    default n

config SUPPORT_GCOV
	bool "Analyze code coverage"
    default n

if SUPPORT_GCOV

menu "GCOV enable section"

config SUPPORT_GCOV_ALL
	bool "gcov enable for all files"
	default n

config SUPPORT_GCOV_LIB_HOSTAP
	bool "gcov enable for lib/hostap, wpa_supplican..."
	default n

config SUPPORT_GCOV_LIB_LWIP
	bool "gcov enable for lib/lwip."
	default n

config SUPPORT_GCOV_WLAN
	bool "gcov enable for Senscomm wlan"
	default n

config SUPPORT_GCOV_BLE
	bool "gcov enable for Senscomm ble"
	default n

config SUPPORT_GCOV_LIB_NIMBLE
	bool "gcov enable for lib/nimble."
	default n

config SUPPORT_GCOV_TUSB
	bool "gcov enable for tusb."
	default n

config SUPPORT_GCOV_SCDC
	bool "gcov enable for scdc."
	default n

endmenu

endif # SUPPORT_GCOV

config SUPPORT_CPP
	bool "Support C++"
    default n

if SUPPORT_CPP

menu "C++ support"

config CPP_STATIC_INIT
	bool "Run C++ static constructors"
    default n

endmenu

endif # SUPPORT_CPP

endmenu # General setup

menu "Power management"

config PM_IO
	bool "Enable control IO during PM"
	default n

config PM_DEBUG
	bool "Enable debugging log"
	default n

config PM_WISE_RTC_CAL
	bool "Enable rtc cal in wise"
	default n

endmenu

menuconfig FS
	bool "Filesystem support"
	default y

if FS

source hal/fs/Kconfig

endif

menuconfig NET
	bool "Networking support"
	default y

if NET

menuconfig WLAN
	bool "IEEE802.11 Wireless LAN"
	default y
	select NET80211

if WLAN
source lib/net80211/Kconfig
endif

source lib/lwip/Kconfig.mem
source lib/lwip/Kconfig

if LWIP

source lib/lwip/Kconfig.socket
source lib/lwip/Kconfig.inet
source lib/lwip/Kconfig.inet6
source lib/lwip/Kconfig.datalink
source lib/lwip/Kconfig.core
source lib/lwip/Kconfig.freertos

endif

endif # if NET

source hal/drivers/Kconfig
```

## kernel/cmsis-freertos/Kconfig
```kconfig
config CMSIS_FREERTOS
	bool
	default y
	select FREERTOS
	help
	 Include FreeRTOS port for CMSIS-RTOS2

config LOW_MEMORY_LOW_THRESHOLD
	int
	default 3000

config LOW_MEMORY_HIGH_THRESHOLD
	int
	default 15000
```

## kernel/freebsd/Kconfig
```kconfig
config FREEBSD
	bool
	default y

if FREEBSD

config FREEBSD_MBUF_CHUNK_SIZE
	int
	default 1120

config FREEBSD_MBUF_CACHE_SIZE
	int
	default 1024

config FREEBSD_MBUF_DYNA_EXT
	bool
	default n

config FREEBSD_ASSERT
	int
	default 2
	help
	0: KASSERT() becomes empty
	1: KASSERT() causes the kernel crash
	2: KASSERT() prints file, line, function info and causes the crash.	

config FREEBSD_IF_PRINTF
	bool
	default y
	help
	Say Y to make if_printf() print out messages

config FREEBSD_IC_PRINTF
	bool
	default y
	help
	Say Y to make ic_printf() print out messages

config FREEBSD_VAP_PRINTF
	bool
	default n
	help
	Say Y to make vap_printf() print out messages

config FREEBSD_CALLOUT_OPTIMIZE
	bool
	default y
	help
	This option reduces overhead of deleting and reallocating os timer
	associated with a callout in callout_reset() by reusing the timer.

config FREEBSD_ALLOW_MBUF_CHAIN
	bool
	default n
	help
	This option reduces overhead of allocating a big chunk and
	copying data from pbuf into it by embedding it's buffer
	address pointed by an external pointer inside mbuf instance(s).

endif
```
