## app/ayla/Kconfig
```kconfig
menu "Ayla configuration"

config AYLA_WIFI_SUPPORT
	bool "Ayla Wi-Fi support"
	default y

config AYLA_WIFI_SETUP_CLEARTEXT_SUPPORT
	bool "Ayla Wi-Fi setup in cleartext mode support"
	depends on AYLA_WIFI_SUPPORT
	default y

config AYLA_BLUETOOTH_SUPPORT
	bool "Ayla Bluetooth support"
	default y

config AYLA_LOCAL_CONTROL_SUPPORT
	bool "Ayla Local Control support"
	default y

config AYLA_LOCAL_CONTROL_SUPPORT_WLT
	bool "Ayla Local Control support WLT protocols"
	depends on AYLA_LOCAL_CONTROL_SUPPORT
	default n

choice
    prompt "Product class"
    default AYLA_BULB

config AYLA_BULB
    bool "Bulb"

config AYLA_PLUG
    bool "Plug"

config AYLA_STRIP
    bool "Strip"

config AYLA_LEDEVB
    bool "LEDEVB"
    help
      Obsoleted

endchoice

endmenu
```

## hal/drivers/clk/Kconfig
```kconfig
menu "Clock"

config CLK
	bool "Enable clock driver support"
	help
	  This allows drivers to be provided for clock generators, including
	  oscillators and PLLs. Devices can use a common clock API to request
	  a particular clock rate and check on available clocks. Clocks can
	  feed into other clocks in a tree structure, with multiplexers to
	  choose the source for each clock.

if CLK

choice
    prompt "Clock driver"

config CLK_SCM2020
	bool "Clock controller driver for SCM2020"

config CLK_TS8266
	bool "Clock controller driver for TS8266"

config CLK_SCM1010
	bool "Clock controller driver for SCM1010"

config CLK_BCM2836
	bool "Clock controller driver for BCM2836"

config CLK_AE250_N22
	bool "Clock controller driver for AE250-N22"

config CLK_SCM2010
	bool "Clock controller driver for SCM2010"

endchoice

config CMD_CLK
	bool "clk command"
	default n
	depends on CMDLINE

endif

endmenu
```
