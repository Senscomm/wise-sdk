## api/wise/Kconfig
```kconfig
menuconfig WISE_API
	bool "wise API"
	default y
	help
	 Enable wise API.

if WISE_API

config WISE_API_WIFI
	bool "Enable Wise WiFi API"
	depends on WPA_SUPPLICANT && LWIP
	default y

config WISE_API_SYSTEM
	bool "Enable Wise System API"
	default y

config WISE_API_TASK_WATCHDOG
	bool "Enable Wise task watchdog API"
	default "n"

if WISE_API_TASK_WATCHDOG
config TASK_WATCHDOG_RESET
	bool "Reset device when expire task watchdog"
	default "n"

config CMD_TASK_WATCHDOG_TEST
	bool "Task watchdog test command"
	default "n"
endif

menu "Log output"

choice LOG_DEFAULT_LEVEL
   bool "Default log verbosity"
   default LOG_DEFAULT_LEVEL_INFO
   help
       Specify how much output to see in logs by default.
       You can set lower verbosity level at runtime using
       esp_log_level_set function.

       Note that this setting limits which log statements
       are compiled into the program. So setting this to, say,
       "Warning" would mean that changing log level to "Debug"
       at runtime will not be possible.

config LOG_DEFAULT_LEVEL_NONE
   bool "No output"
config LOG_DEFAULT_LEVEL_ERROR
   bool "Error"
config LOG_DEFAULT_LEVEL_WARN
   bool "Warning"
config LOG_DEFAULT_LEVEL_INFO
   bool "Info"
config LOG_DEFAULT_LEVEL_DEBUG
   bool "Debug"
config LOG_DEFAULT_LEVEL_VERBOSE
   bool "Verbose"
endchoice

config LOG_DEFAULT_LEVEL
    int
    default 0 if LOG_DEFAULT_LEVEL_NONE
    default 1 if LOG_DEFAULT_LEVEL_ERROR
    default 2 if LOG_DEFAULT_LEVEL_WARN
    default 3 if LOG_DEFAULT_LEVEL_INFO
    default 4 if LOG_DEFAULT_LEVEL_DEBUG
    default 5 if LOG_DEFAULT_LEVEL_VERBOSE

config LOG_COLORS
   bool "Use ANSI terminal colors in log output"
   default y
   help
      Enable ANSI terminal color codes in bootloader output.

      In order to view these, your terminal program must support ANSI color codes.

endmenu

config LOG_BUF_SIZE
	int "Print bytes at one time"
	default 1024
	range 128 1024
	help
		The maximum number of bytes to print at one time.

endif # WISE_API
```

## app/Kconfig
```kconfig
choice
	prompt "Applications"

config DEMO_CMDLINE
	bool "Command-line demo"

config DEMO_API_WIFI
	bool "Wi-Fi API demo"
	select SDK
	select API_WIFI
	select CLI_WIFI
	select CLI_WIFI_STA
	select CLI_WIFI_SOFTAP
	select CLI_WIFI_SCAN
	select CLI_WIFI_DHCP

config DEMO_BLE
	bool "BLE demo"

config DEMO_PROTOS
	bool "Protocols Demo"

config DEMO_PERIPHERALS
    bool "Peripherals Demo"

config DEMO_POWERSAVE
    bool "Power Save Demo"

config DEMO_HOW_TO_DEBUG
	bool "How-to-debug demo"
	select CMDLINE

config EXT_APP
	bool "Ext Applications"

config MCUBOOT_BL
    bool "wise-mcuboot"

config TEST_PERIPHERALS
 	bool "peripherals test"

endchoice

if DEMO_API_WIFI
source "api/examples/wifi/Kconfig"
endif

if DEMO_BLE
source "api/examples/ble/Kconfig"
endif

if DEMO_PROTOS
source "api/examples/protocols/Kconfig"
endif

if DEMO_PERIPHERALS
source "api/examples/peripherals/Kconfig"
endif

if DEMO_POWERSAVE
source "api/examples/power_save/Kconfig"
endif

if TEST_PERIPHERALS
source api/examples/test/peripherals/Kconfig
endif

if DEMO_HOW_TO_DEBUG
source "app/how-to-debug/Kconfig"
endif

if MCUBOOT_BL
source "app/mcuboot/Kconfig"
endif
```

## app/ayla/ayla_demo/sdkconfig.defaults
```kconfig
#
# Copyright 2022 Ayla Networks, Inc.  All rights reserved.
#
# The common configuration for all platforms.
#

#
# Limit the log level.
#
CONFIG_LOG_COLORS=n
CONFIG_LOG_DEFAULT_LEVEL_ERROR=y

#
# Require 4M bytes flash to support OTA.
#
CONFIG_ESPTOOLPY_FLASHSIZE_4MB=y

#
# Set the offset of the partition table to support the large bootloader.
#
CONFIG_PARTITION_TABLE_OFFSET=0xe000

#
# Customize the partition table.
#
CONFIG_PARTITION_TABLE_CUSTOM=y
CONFIG_PARTITION_TABLE_CUSTOM_FILENAME="ayla_flash_partitions_v3.csv"

#
# Optimized system configurations.
#
CONFIG_ESP_NETIF_TCPIP_ADAPTER_COMPATIBLE_LAYER=n
CONFIG_ESP32_WIFI_CSI_ENABLED=y
CONFIG_ESP32_WIFI_DYNAMIC_RX_BUFFER_NUM=16
CONFIG_ESP32_WIFI_DYNAMIC_TX_BUFFER_NUM=16
CONFIG_ESP32_WIFI_IRAM_OPT=n
CONFIG_ESP32_WIFI_STATIC_RX_BUFFER_NUM=6
CONFIG_ESP32_WIFI_SW_COEXIST_ENABLE=n
CONFIG_FREERTOS_HZ=1000
CONFIG_FREERTOS_THREAD_LOCAL_STORAGE_POINTERS=2
CONFIG_FREERTOS_TIMER_TASK_STACK_DEPTH=4096
CONFIG_FREERTOS_USE_STATS_FORMATTING_FUNCTIONS=n
CONFIG_FREERTOS_USE_TRACE_FACILITY=y
CONFIG_LWIP_ETHARP_TRUST_IP_MAC=y
CONFIG_LWIP_MAX_SOCKETS=16
CONFIG_LWIP_TCP_MSS=1220
CONFIG_LWIP_TCP_OVERSIZE_MSS=n
CONFIG_LWIP_TCP_OVERSIZE_QUARTER_MSS=y
CONFIG_LWIP_TCP_SND_BUF_DEFAULT=2440
CONFIG_LWIP_TCP_SYNMAXRTX=6
CONFIG_LWIP_TCP_WND_DEFAULT=2440
CONFIG_LWIP_TCPIP_RECVMBOX_SIZE=24
CONFIG_SPI_SLAVE_ISR_IN_IRAM=n

#
# Customize the memory management for MBEDTLS.
#
CONFIG_MBEDTLS_CUSTOM_MEM_ALLOC=y

#
# Disable trusted root certificate bundle.
#
CONFIG_MBEDTLS_CERTIFICATE_BUNDLE=n

#
# Disable the TLS 1.0 and 1.1
#
CONFIG_MBEDTLS_SSL_PROTO_TLS1=n
CONFIG_MBEDTLS_SSL_PROTO_TLS1_1=n

#
# Enable certificate expiry check.
#
CONFIG_MBEDTLS_HAVE_TIME_DATE=y

#
# Only need the TLS client.
#
CONFIG_MBEDTLS_TLS_CLIENT_ONLY=y

#
# Disable support for PSK (pre-shared key) modes.
#
CONFIG_MBEDTLS_KEY_EXCHANGE_DHE_PSK=n
CONFIG_MBEDTLS_KEY_EXCHANGE_ECDHE_PSK=n
CONFIG_MBEDTLS_KEY_EXCHANGE_PSK=n
CONFIG_MBEDTLS_KEY_EXCHANGE_RSA_PSK=n
CONFIG_MBEDTLS_PSK_MODES=n

#
# Enable core dump.
#
CONFIG_ESP_COREDUMP_ENABLE_TO_FLASH=y
CONFIG_ESP_COREDUMP_CHECKSUM_SHA256=y
CONFIG_ESP_COREDUMP_MAX_TASKS_NUM=16

#
# Enable the task tracking to optimize the stack size.
#
CONFIG_HEAP_TASK_TRACKING=y
CONFIG_HEAP_POISONING_COMPREHENSIVE=y

#
# Enable Bluetooth.
#
CONFIG_BT_ENABLED=y

#
# Enable Bluetooth nimble.
#
CONFIG_BT_NIMBLE_ENABLED=y
CONFIG_BT_NIMBLE_LOG_LEVEL_WARNING=y
CONFIG_BT_NIMBLE_ACL_BUF_COUNT=12
CONFIG_BT_NIMBLE_ATT_PREFERRED_MTU=512
CONFIG_BT_NIMBLE_MAX_BONDS=5
CONFIG_BT_NIMBLE_MAX_CCCDS=15
CONFIG_BT_NIMBLE_ROLE_BROADCASTER=n
CONFIG_BT_NIMBLE_ROLE_CENTRAL=n
CONFIG_BT_NIMBLE_ROLE_OBSERVER=n

#
# Enable watchdog.
#
CONFIG_ESP_TASK_WDT_PANIC=y
CONFIG_ESP_TASK_WDT_TIMEOUT_S=25

#
# Disable Ethernet interface.
#
CONFIG_ETH_USE_SPI_ETHERNET=n
```

## app/ayla/ayla_demo/sdkconfig.defaults.esp32
```kconfig
#
# Copyright 2022 Ayla Networks, Inc.  All rights reserved.
#
# The configuration for ESP32.
#

#
# Backward compatible with versions prior to v1.13.
#
# If a new product is started, it is recommended to use the v3 partition
# table and partition table offset 0xe000.
#
CONFIG_PARTITION_TABLE_CUSTOM_FILENAME="ayla_flash_partitions.csv"
CONFIG_PARTITION_TABLE_OFFSET=0x8000

#
# Disable Ethernet interface.
#
CONFIG_ETH_USE_ESP32_EMAC=n

#
# The optimized the stack size.
#
CONFIG_ESP_IPC_TASK_STACK_SIZE=1024
CONFIG_ESP_MAIN_TASK_STACK_SIZE=3700
CONFIG_ESP_SYSTEM_EVENT_TASK_STACK_SIZE=3000
CONFIG_ESP_TIMER_TASK_STACK_SIZE=2048
CONFIG_FREERTOS_TIMER_TASK_STACK_DEPTH=4096
CONFIG_LWIP_TCPIP_TASK_STACK_SIZE=4000
CONFIG_MDNS_TASK_STACK_SIZE=2400

#
# Keeps compatible with the old version sdkconfig.defaults.esp32
#
CONFIG_BTDM_CTRL_FULL_SCAN_SUPPORTED=n
CONFIG_BTDM_SCAN_DUPL_CACHE_SIZE=25
CONFIG_ESP_IPC_USES_CALLERS_PRIORITY=n
CONFIG_FREERTOS_IDLE_TASK_STACKSIZE=1024
CONFIG_MBEDTLS_HARDWARE_MPI=n
CONFIG_MBEDTLS_HARDWARE_SHA=n
```

## app/ayla/ayla_demo/sdkconfig.defaults.esp32c3
```kconfig
#
# Copyright 2022 Ayla Networks, Inc.  All rights reserved.
#
# The configuration for ESP32c3.
#

#
# Backward compatible with versions prior to v1.13.
#
# If a new product is started, it strongly recommends to delete all compatible
# configurations. If there are already products on the market, just upgrade
# the agent to solve bugs or add new functions, please keep it.
#
#CONFIG_PARTITION_TABLE_CUSTOM_FILENAME="ayla_flash_partitions.csv"

#
# The optimized the stack size.
#
CONFIG_ESP_IPC_TASK_STACK_SIZE=1024
CONFIG_ESP_MAIN_TASK_STACK_SIZE=4000
CONFIG_ESP_SYSTEM_EVENT_TASK_STACK_SIZE=4096
CONFIG_ESP_TIMER_TASK_STACK_SIZE=2050
CONFIG_FREERTOS_IDLE_TASK_STACKSIZE=1500
CONFIG_LWIP_TCPIP_TASK_STACK_SIZE=4600
CONFIG_MDNS_TASK_STACK_SIZE=2400

#
# The BT configurations for ESP32c3.
#
CONFIG_BT_CTRL_LPCLK_SEL_MAIN_XTAL=y
CONFIG_BT_CTRL_LPCLK_SEL_RTC_SLOW=n
CONFIG_BT_CTRL_MODEM_SLEEP_MODE_1=y
CONFIG_BT_CTRL_MODEM_SLEEP=y
CONFIG_BT_CTRL_SLEEP_CLOCK_EFF=1
CONFIG_BT_CTRL_SLEEP_MODE_EFF=1
CONFIG_BT_NIMBLE_ENABLE_CONN_REATTEMPT=n
CONFIG_BT_NIMBLE_HOST_BASED_PRIVACY=y
CONFIG_BT_NIMBLE_HS_FLOW_CTRL_ITVL=1000
CONFIG_BT_NIMBLE_HS_FLOW_CTRL_THRESH=2
CONFIG_BT_NIMBLE_HS_FLOW_CTRL_TX_ON_DISCONNECT=y
CONFIG_BT_NIMBLE_HS_FLOW_CTRL=y

#
# Keeps compatible with the old version sdkconfig.defaults.esp32c3
#
CONFIG_ESPTOOLPY_FLASHMODE_QIO=y
CONFIG_LWIP_DNS_SUPPORT_MDNS_QUERIES=n
```

## app/ayla/ayla_matter_demo/sdkconfig.defaults
```kconfig
#
# Copyright 2022 Ayla Networks, Inc.  All rights reserved.
#
# The common configuration for all platforms.
#

#
# Limit the log level.
#
CONFIG_BOOTLOADER_LOG_LEVEL_NONE=y
CONFIG_LOG_COLORS=n
CONFIG_LOG_DEFAULT_LEVEL_ERROR=y

#
# Require 4M bytes flash to support OTA.
#
CONFIG_ESPTOOLPY_FLASHSIZE_4MB=y

#
# Set the offset of the partition table to support the large bootloader.
#
CONFIG_PARTITION_TABLE_OFFSET=0xe000

#
# Customize the partition table.
#
CONFIG_PARTITION_TABLE_CUSTOM=y
CONFIG_PARTITION_TABLE_CUSTOM_FILENAME="partitions.csv"

#
# Optimized system configurations.
#
CONFIG_ESP32_WIFI_CSI_ENABLED=y
CONFIG_ESP32_WIFI_DYNAMIC_RX_BUFFER_NUM=16
CONFIG_ESP32_WIFI_DYNAMIC_TX_BUFFER_NUM=16
CONFIG_ESP32_WIFI_STATIC_RX_BUFFER_NUM=6
CONFIG_FREERTOS_HZ=1000
CONFIG_FREERTOS_THREAD_LOCAL_STORAGE_POINTERS=2
CONFIG_FREERTOS_TIMER_TASK_STACK_DEPTH=4096
CONFIG_FREERTOS_USE_TRACE_FACILITY=y
CONFIG_LWIP_ETHARP_TRUST_IP_MAC=y
CONFIG_LWIP_MAX_SOCKETS=16
CONFIG_LWIP_TCP_MSS=1220
CONFIG_LWIP_TCP_OVERSIZE_QUARTER_MSS=y
CONFIG_LWIP_TCP_SND_BUF_DEFAULT=2440
CONFIG_LWIP_TCP_SYNMAXRTX=6
CONFIG_LWIP_TCP_WND_DEFAULT=2440
CONFIG_LWIP_TCPIP_RECVMBOX_SIZE=24
CONFIG_SPI_SLAVE_ISR_IN_IRAM=n

#
# Customize the memory management for MBEDTLS.
#
CONFIG_MBEDTLS_CUSTOM_MEM_ALLOC=y

#
# Disable trusted root certificate bundle.
#
CONFIG_MBEDTLS_CERTIFICATE_BUNDLE=n

#
# Disable the TLS 1.0 and 1.1
#
CONFIG_MBEDTLS_SSL_PROTO_TLS1=n
CONFIG_MBEDTLS_SSL_PROTO_TLS1_1=n
CONFIG_MBEDTLS_SSL_PROTO_TLS1_3=n

#
# Enable certificate expiry check.
#
CONFIG_MBEDTLS_HAVE_TIME_DATE=y

#
# Only need the TLS client.
#
CONFIG_MBEDTLS_TLS_CLIENT_ONLY=y

#
# Disable support for PSK (pre-shared key) modes.
#
CONFIG_MBEDTLS_KEY_EXCHANGE_DHE_PSK=n
CONFIG_MBEDTLS_KEY_EXCHANGE_ECDHE_PSK=n
CONFIG_MBEDTLS_KEY_EXCHANGE_PSK=n
CONFIG_MBEDTLS_KEY_EXCHANGE_RSA_PSK=n
CONFIG_MBEDTLS_PSK_MODES=n

#
# It needs by the CHIP stack.
#
CONFIG_MBEDTLS_HKDF_C=y

#
# Enable core dump.
#
CONFIG_ESP_COREDUMP_ENABLE_TO_FLASH=y
CONFIG_ESP_COREDUMP_CHECKSUM_SHA256=y
CONFIG_ESP_COREDUMP_MAX_TASKS_NUM=16

#
# Enable the task tracking to optimize the stack size.
#
CONFIG_HEAP_TASK_TRACKING=y
CONFIG_HEAP_POISONING_COMPREHENSIVE=y

#
# Enable Bluetooth.
#
CONFIG_BT_ENABLED=y

#
# Enable Bluetooth nimble.
#
CONFIG_BT_NIMBLE_ENABLED=y
CONFIG_BT_NIMBLE_LOG_LEVEL_WARNING=y
CONFIG_BT_NIMBLE_MAX_BONDS=1
CONFIG_BT_NIMBLE_MAX_CCCDS=4
CONFIG_BT_NIMBLE_MAX_CONNECTIONS=1
CONFIG_BTDM_CTRL_BLE_MAX_CONN=1
CONFIG_BTDM_CTRL_MODE_BLE_ONLY=y

#
# Enable watchdog.
#
CONFIG_ESP_TASK_WDT_PANIC=y
CONFIG_ESP_TASK_WDT_TIMEOUT_S=25

#
# Disable Ethernet interface.
#
CONFIG_ETH_USE_SPI_ETHERNET=n

#
# IPV6 settings.
#
CONFIG_LWIP_HOOK_IP6_ROUTE_DEFAULT=y
CONFIG_LWIP_HOOK_ND6_GET_GW_DEFAULT=y
CONFIG_LWIP_IPV6_AUTOCONFIG=y

#
# Matter settings.
#
CONFIG_DEVICE_PRODUCT_ID=0x8001

CONFIG_EVENT_LOGGING_CRIT_BUFFER_SIZE=1024
CONFIG_EVENT_LOGGING_DEBUG_BUFFER_SIZE=512
CONFIG_EVENT_LOGGING_INFO_BUFFER_SIZE=512
CONFIG_EVENT_LOGGING_PROD_BUFFER_SIZE=512

#
# Settings for libadm.
#
CONFIG_RENDEZVOUS_MODE_BLE=y

CONFIG_FREERTOS_ENABLE_BACKWARD_COMPATIBILITY=y

CONFIG_ESP32_WIFI_RX_IRAM_OPT=n
```

## app/ayla/ayla_matter_demo/sdkconfig.defaults.esp32
```kconfig
#
# Copyright 2022 Ayla Networks, Inc.  All rights reserved.
#
# The configuration for esp32 platforms.
#
CONFIG_ESP32_REV_MIN_3=y
```

## app/ayla/components/adm/Kconfig
```kconfig
#
#    Copyright 2022 Ayla Networks, Inc.  All rights reserved.
#
#    Description:
#      Configuration options for AylaDevKit application.
#

menu "Ayla libadm options"
    choice
      prompt "Rendezvous Mode"
      default RENDEZVOUS_MODE_ON_NETWORK
      help
          Specifies the Rendezvous mode of the peripheral.

      config RENDEZVOUS_MODE_SOFTAP
          bool "Soft-AP"
      config RENDEZVOUS_MODE_BLE
          bool "BLE"
          depends on BT_ENABLED
      config RENDEZVOUS_MODE_ON_NETWORK
          bool "On-Network"
      config RENDEZVOUS_MODE_SOFTAP_ON_NETWORK
          bool "Soft-AP / On-Network"
      config RENDEZVOUS_MODE_BLE_ON_NETWORK
          bool "BLE / On-Network"
    endchoice

    config RENDEZVOUS_MODE
       int
       range 0 8
       default 1 if RENDEZVOUS_MODE_SOFTAP
       default 2 if RENDEZVOUS_MODE_BLE
       default 4 if RENDEZVOUS_MODE_ON_NETWORK
       default 5 if RENDEZVOUS_MODE_SOFTAP_ON_NETWORK
       default 6 if RENDEZVOUS_MODE_BLE_ON_NETWORK
endmenu
```

## app/how-to-debug/Kconfig
```kconfig
menu "How-to-debug demo configuration"

choice
	prompt "Type of debugging"

config DEBUG_TYPE_EXCEPTION 
    bool "Debugging core exceptions"

config DEBUG_TYPE_ASSERTION 
    bool "Debugging assertion failures"

config DEBUG_TYPE_STACK_OVF
    bool "Debugging stack overruns"

config DEBUG_TYPE_HEAP_LEAK
    bool "Debugging memory (heap) leaks"

endchoice

endmenu
```

## app/mcuboot/Kconfig
```kconfig
menu "MCUBoot related configuration"

comment "Build"

config BOOT_BIN
	string "Name of the boot loader binary file"
	default "wise.scmboot.bin"

config BOOT_TIMEOUT
    int "Seconds to wait before entering CLI mode"
    default 3


endmenu
```
