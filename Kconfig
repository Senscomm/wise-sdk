## Kconfig
```kconfig
#
# For a description of the syntax of this configuration file,
# see the file Documentation/kbuild/kconfig-language.txt in the
# Linux kernel source tree.
#

# WISE: WIRELESS IOT SMART EDGE
#
mainmenu "WISE Configuration"

menu "Target platform"
source "hal/arch/Kconfig"
source "hal/soc/Kconfig"
source "hal/board/Kconfig"
endmenu

menu "Kernel"
source "kernel/Kconfig"
endmenu

#source "hal/drivers/Kconfig"

menu "Libraries/middleware"
source "lib/serial/Kconfig"
source "lib/crypto/Kconfig"
source "lib/stdlib/Kconfig"
source "lib/scdc/Kconfig"
source "lib/hostap/wpa_supplicant/Kconfig"
source "lib/mbedtls-2.16.2/library/Kconfig"
source "lib/net/mqtt/Kconfig"
source "lib/libifconfig/Kconfig"
source "lib/nuttx/Kconfig"
source "lib/sdio/Kconfig"
source "lib/repeater/Kconfig"
source "lib/net/Kconfig"
endmenu

source "lib/cli/Kconfig"
source "lib/at/Kconfig"
source "lib/tinycrypt/Kconfig"
source "lib/ble/Kconfig"
source "lib/tinyusb/Kconfig"
source "lib/scm_mcuboot/Kconfig"

source "api/Kconfig"

menu "Applications"
source "app/Kconfig"
endmenu
```

## api/Kconfig
```kconfig
menuconfig SDK
	bool "SDK"
	default y
	help
	 Enable public APIs in SDK build.

if SDK

config USE_DMA_ALLOCATION
	bool "Use DMA allocation"
	default y
	depends on SUPPORT_DMA_DYNAMIC_ALLOC

config API_WIFI
	bool "Include Wi-FI APIs"
	default y
	depends on NET80211
	select WISE_API
	help
	 Include Wi-Fi APIs in SDK

if API_WIFI

menu "Wi-Fi API"

config API_SOFTAP
    bool "Include Senscomm SoftAP APIs"
	default y
	help
	 Include Senscomm SoftAP APIs in SDK

config API_SCAN
    bool "Include Senscomm Scan APIs"
	default y
	help
	 Include Senscomm Scan APIs in SDK

config API_SCMCHANNEL
	bool "Include Senscomm Channel APIs"
	default n
	depends on SCDC_SUPPORT_SCM_CHANNEL
	help
	 Include Senscomm Channel APIs in SDK

config API_WATCHER
    bool "Include Senscomm WATCHER APIs"
	default y
	depends on PM_SCM2010
	help
	 Include Senscomm WATCHER APIs in SDK

config API_MONITOR
    bool "Include Senscomm Wi-Fi Monitor APIs"
	default n
	help
	 Include Senscomm Wi-Fi Monitor APIs in SDK

endmenu
endif # API_WIFI

config CLI_WIFI
	bool "Include Wi-FI CLIs for API testing"
	default y
	depends on API_WIFI
	help
	 Include Wi-Fi CLIs in SDK

if CLI_WIFI

menu "Wi-Fi CLI"

config CLI_WIFI_STA
	bool "Include Wi-Fi STA CLIs for API testing"
	default y
	help
	 Include Wi-Fi STA CLIs in SDK

config CLI_WIFI_SOFTAP
	bool "Include Wi-Fi SAP CLIs for API testing"
	default y
	select API_SOFTAP
	help
	 Include Wi-Fi SAP CLIs in SDK

config CLI_WIFI_WATCHER
	bool "Include Wi-Fi WATCHER CLIs for API testing"
	default y
	depends on API_WATCHER
	help
	 Include Wi-Fi WATCHER CLIs in SDK

config CLI_WIFI_SCAN
	bool "Include Wi-Fi SCAN CLIs for API testing"
	default y
	select API_SCAN
	help
	 Include Wi-Fi SCAN CLIs in SDK

config CLI_WIFI_DHCP
	bool "Include WI-FI DHCP CLIs for API Testing"
	default y
	help
	 Include Wi-Fi DHCP CLIs for API Testing

config CLI_WIFI_SCMCHANNEL
	bool "Include WI-FI SCMCHANNEL CLIs for API Testing"
	default n
	depends on API_SCMCHANNEL
	depends on SUPPORT_WIFI_REPEATER
	help
	 Include Wi-Fi SCMCHANNEL CLIs for API Testing

config CLI_WIFI_MONITOR
	bool "Include WI-FI Monitor CLIs for API Testing"
	default n
	depends on API_MONITOR
	help
	 Include Wi-Fi MONITOR CLIs for API Testing

config CLI_WIFI_CHANNEL
	bool "Include Wi-Fi Channel CLIs for API testing"
	default n
	help
	 Include Wi-Fi CHANNEL CLIs in SDK

config CLI_WIFI_POWER
	bool "Include Wi-Fi Tx power setting or query"
	default n
	help
	 Include Wi-Fi Tx Power CLIs in SDK

endmenu
endif # CLI_WIFI

config API_PM
	bool "Include PM APIs"
	default y
	depends on PM_SCM2010
	select API_GPIO
	help
	 Include PM APIs in SDK

config CLI_PM
	bool "Include PM CLIs for API testing"
	depends on API_PM
	default y
	help
	 Include PM CLIs in SDK

config API_EFUSE
	bool "Include EFUSE APIs"
	default n
	select EFUSE
	help
	 Include EFUSE APIs in SDK

config CLI_EFUSE
	bool "Include EFUSE CLIs for API testing"
	depends on API_EFUSE
	default n
	help
	 Include EFUSE CLIs in SDK

config API_GPIO
	bool "Include GPIO APIs"
	select PINCTRL
	default y
	help
	 Include GPIO APIs in SDK

config CLI_GPIO
	bool "Include GPIO CLIs for API testing"
	depends on API_GPIO
	default n
	help
	 Include GPIO CLIs in SDK

config API_CRYPTO
	bool "Include CRYPTO APIs"
	default n
	help
	 Include CRYPTO APIs in SDK

config CLI_CRYPTO
	bool "Include CRYPTO CLIs for API testing"
	depends on API_CRYPTO
	default n
	help
	 Include CRYPTO CLIs in SDK

config API_ADC
	bool "Include ADC APIs"
	default n
	select ADC
	help
	 Include ADC APIs in SDK

config CLI_ADC
	bool "Include ADC CLIs for API testing"
	depends on API_ADC
	default n
	help
	 Include ADC CLIs in SDK


config API_I2C
	bool "Include I2C APIs"
	default n
	select I2C
	help
	 Include I2C APIs in SDK

config CLI_I2C
	bool "Include I2C CLIs for API testing"
	depends on API_I2C
	default n
	help
	 Include I2C CLIs in SDK

config API_SPI
	bool "Include SPI APIs"
	default n
	select SPI
	help
	 Include SPI APIs in SDK

config CLI_SPI
	bool "Include SPI CLIs for API testing"
	depends on API_SPI
	default n
	help
	 Include SPI CLIs in SDK

config API_UART
	bool "Include UART APIs"
	default n
	select SERIAL
	help
	 Include UART APIs in SDK

config CLI_UART
	bool "Include UART CLIs for API testing"
	depends on API_UART
	default n
	help
	 Include UART CLIs in SDK

config CLI_UARTBUF_MAXLEN
	int "Max UART TX/RX buffer length"
	depends on CLI_UART
	default 256
	help
	 Maximum UART TX/RX buffer length for API testing.

config API_TIMER
	bool "Include Timer APIs"
	select TIMER
	default n
	help
	 Include Timer APIs in SDK

config CLI_TIMER
	bool "Include Timer CLIs for API testing"
	depends on API_TIMER
	default n
	help
	 Include Timer CLIs in SDK

config API_PTA
	bool "Include PTA APIs"
	depends on PTA
	default n
	help
	 Include PTA APIs in SDK

config CLI_PTA
	bool "Include PTA CLIs for API testing"
	depends on API_PTA
	default n
	help
	 Include PTA CLIs in SDK

config API_WDT
	bool "Include Watchdog APIs"
	depends on WDT
	default n
	help
	 Include Watchdog APIs in SDK

config CLI_FS
	bool "Include FS CLIs"
	select XYZMODEM
	default n
	help
	 Include FS CLIs in SDK

config API_I2S
	bool "Include I2S APIs"
	default n
	select I2S
	help
	 Include I2S APIs in SDK

config CLI_I2S
	bool "Include I2S CLIs for API testing"
	depends on API_I2S
	default n
	help
	 Include I2S CLIs in SDK

config API_AUDIO
	bool "Include Audio APIs"
	default n
	select I2S
	select AUDIO
	help
	 Include Audio APIs in SDK

config CLI_AUDIO
	bool "Include Audio CLIs for API testing"
	depends on API_AUDIO
	default n
	help
	 Include Audio CLIs in SDK

endif # SDK

source "api/wise/Kconfig"
```

## api/examples/ble/Kconfig
```kconfig
choice
	prompt "BLE Demo"

config DEMO_NIMBLE
    bool "NIMBLE BLE Demo"
	select CMDLINE
    depends on BLE_NIMBLE_HOST

endchoice

if DEMO_NIMBLE
source "api/examples/ble/nimble/Kconfig"
endif
```

## api/examples/ble/nimble/Kconfig
```kconfig
if DEMO_NIMBLE

choice
    prompt "NIMBLE BLE demo select"
    default NIMBLE_BLECLI

config NIMBLE_BLE_SIMPLE
    bool "NIMBLE BLE simple demo(peripheral/central)"

config NIMBLE_BLECLI
    bool "NIMBLE BLE CLI demo"

config NIMBLE_BLEHOGP
    bool "NIMBLE BLE HID over GATT profile demo"

config NIMBLE_BLECOMP
    bool "NIMBLE BLE compatibility test demo"

endchoice

config NIMBLE_DEFAULT_APP
	string
    default "bt init" if NIMBLE_BLECLI
    default "blehogp" if NIMBLE_BLEHOGP
    default "blecomp" if NIMBLE_BLECOMP

if NIMBLE_BLECLI

config NIMBLE_PTS
    bool "NIMBLE BLE CLI for PTS"
    default n

endif

endif
```

## api/examples/peripherals/Kconfig
```kconfig
choice
	prompt "Peripherals Demo"

config DEMO_LEDC_BLINK
    bool "LED Control Demo - BLINK"
	select WISE_API
	select API_GPIO
    help
     Include LED Control BLINK Demo in SDK

config DEMO_LEDC_PWM
    bool "LED Control Demo - PWM"
	select WISE_API
	select API_GPIO
	select API_TIMER
	select CLI_TIMER
	select USE_TIMER0
	select USE_TIMER1
    help
     Include LED Control PWM Demo in SDK

config DEMO_I2C_EEPROM_SIM
    bool "I2C EEPROM Simulation "
	select WISE_API
	select USE_I2C0
	select USE_I2C1
	select I2C
	select DMA
	select API_I2C
    help
     Include I2C EEPROM simulation

config DEMO_SPI_TRANSFER
    bool "SPI transfer Demo"
	select WISE_API
	select USE_SPI1
	select USE_SPI2
	select SPI
	select DMA
	select API_SPI
    help
     Include SPI transfer demo

config DEMO_ADC
    bool "ADC value read Demo"
	select WISE_API
	select USE_AUXADC
	select ADC
	select API_ADC
    help
     Include ADC value read demo

config DEMO_ADC_TEMPERATURE
    bool "ADC temperature Demo"
	select WISE_API
	select USE_AUXADC
	select ADC
	select API_ADC
    help
     Include read temperature value via ADC demo

config DEMO_TIMER_PWM_IR
    bool "TIMER PWM IR Demo"
	select WISE_API
	select USE_TIMER0
	select USE_TIMER1
	select USE_TIMER0_PWM
	select USE_TIMER1_PWM
	select TIMER
	select API_TIMER
    help
     Include SPI transfer demo

endchoice
```

## api/examples/power_save/Kconfig
```kconfig
choice
	prompt "Power Save Demo"

config DEMO_POWERSAVE_DTIM10
    bool "Power Save DTIM10 Demo"
    help
     Include Power Save DTIM10 Demo in SDK

endchoice
```

## api/examples/protocols/Kconfig
```kconfig
choice
	prompt "Protocols Demo"
    default DEMO_PROTOCOLS_MQTT

config DEMO_PROTOCOLS_MQTT
    bool "MQTT Demo"
    select SDK
    select API_WIFI
    select MQTT
    select COREMQTT
    select COREMQTT_AGENT
    select TCP_TRANSPORT
    select CMDLINE
	select CLI_FS
    help
     MQTT Subscriber / Publisher Demo

config DEMO_PROTOCOLS_MQTT_UART
    bool "MQTT UART Demo"
    select SDK
    select API_WIFI
    select MQTT
    select COREMQTT
    select CMDLINE
    help
     Include MQTT UART Demo in SDK

config DEMO_PROTOCOLS_HTTP_SERVER
    bool "HTTP Server Demo"
    select SDK
    select API_WIFI
    select LIB_HTTPD
    select CMDLINE
    help
     HTTP Server Demo

config DEMO_PROTOCOLS_COAP
    bool "CoAP Demo"
    select SDK
    select API_WIFI
    select COAP
    select CMDLINE
    help
     CoAP Client / Server Demo

config DEMO_PROTOCOLS_HTTP_CLIENT
    bool "HTTP Client Demo"
    select SDK
    select API_WIFI
    select ESP_HTTP_CLIENT
    select LWIP_SNTP
    select CMDLINE
    select CMD_SNTP
    select CLI_FS
    help
     HTTP Client Demo

endchoice

source "api/examples/protocols/common/Kconfig"

if DEMO_PROTOCOLS_MQTT
source "api/examples/protocols/mqtt/Kconfig"
endif

if DEMO_PROTOCOLS_MQTT_UART
source "api/examples/protocols/mqtt_uart/Kconfig"
endif

if DEMO_PROTOCOLS_HTTP_SERVER
source "api/examples/protocols/http_server/Kconfig"
endif

if DEMO_PROTOCOLS_COAP
source "api/examples/protocols/coap/Kconfig"
endif

if DEMO_PROTOCOLS_HTTP_CLIENT
source "api/examples/protocols/http_client/Kconfig"
endif
```

## api/examples/protocols/coap/Kconfig
```kconfig
menu "CoAP Demo"

config COAP_TCP_SUPPORT
	bool "Support TCP transport"
	default n

config COAP_WEBSOCKETS
	bool "Use WebSockets"
	default n
	depends on COAP_TCP_SUPPORT

config COAP_S_MBEDTLS_PKI
	bool "MbedTLS PKI"
    default y
	select COAP_WITH_MBEDTLS
	select MBEDTLS_KEY_EXCHANGE_ECDH_ECDSA
	select MBEDTLS_KEY_EXCHANGE_ECDHE_ECDSA

config COAP_S_MBEDTLS_PSK
	bool "MbedTLS PSK"
    default y
	select COAP_WITH_MBEDTLS
	select MBEDTLS_KEY_EXCHANGE_PSK

config COAP_WITH_MBEDTLS
	bool
	default n
	select MBEDTLS_ECDH_C
	select MBEDTLS_ECDSA_C
	select MBEDTLS_SSL_PROTO_DTLS if !COAP_TCP_SUPPORT
	select MBEDTLS_DEBUG

endmenu
```

## api/examples/protocols/common/Kconfig
```kconfig
menu "Common"

config DEMO_WIFI_CONF
	bool "include WI-FI Configuration"
	default n
	help
		Automatically start with Wi-Fi configuration

if DEMO_WIFI_CONF

menu "DEMO WI-FI Configuration"

config DEMO_WIFI_SSID
	string "DEMO WIFI SSID"
	default "TestAP"
	help
		SSID (network name) for the example to connect to.

config DEMO_WIFI_PASSWORD
	string "DEMO WiFi Password"
	default "12345678"
	help
		WiFi password (WPA or WPA2) for the example to use.


config DEMO_WIFI_AUTH
	int "DEMO WIFI Auth Type"
	range 0 3
	default 0
	help
		OPEN(0),WPA-PSK(1), WPA2-PSK(2),SAE(3)

config DEMO_WIFI_PAIRWISE
	int "DEMO WIFI PAIRWISE Type"
	range 0 2
	default 0
	help
		None(0),AES(1), TKIP(2)

endmenu

endif # DEMO_WIFI_CONF

endmenu
```

## api/examples/protocols/http_server/Kconfig
```kconfig
choice
	prompt "HTTP Server Demo"
    default DEMO_HTTP_SERVER_SIMPLE

config DEMO_HTTP_SERVER_SIMPLE
    bool "Simple HTTP Server"

endchoice

if DEMO_HTTP_SERVER_SIMPLE
source "api/examples/protocols/http_server/simple/Kconfig"
endif
```

## api/examples/protocols/mqtt/Kconfig
```kconfig
menu "MQTT demo"

config MQTT_DEMO_CLIENT_ID
    string "Identifier of MQTT client"
    default "wise-mqttc"
    help
     Client identifier to be advertised to the MQTT brokder.

config MQTT_DEMO_KEEP_ALIVE_INTERVAL
	int "MQTT Keep Alive Interval in seconds"
	default 60
	help
	  MQTT keep-alive period.

config MQTT_DEMO_CONNACK_RECV_TIMEOUT_MS
	int "MQTT CONNACK Timeout in ms"
	default 1000
	help
      Timeout for receiving CONNACK after sending an MQTT CONNECT packet.
      Defined in milliseconds.

config MQTT_DEMO_AGENT_NETWORK_BUFFER_SIZE
	int "MQTT Agent transport buffer size"
	default 1500
	help
	  Size of a MQTT packet buffer.

config MQTT_DEMO_AGENT_COMMAND_QUEUE_LENGTH
	int "MQTT AGent command queue length"
	default 10
	help
	  Max. number of commands in a MQTT-Agent command queue

endmenu
```

## api/examples/protocols/mqtt_uart/Kconfig
```kconfig
menu "MQTT UART"

config MQTT_MBEDTLS_SUPPORT
	bool "MQTT include MBEDTLS Function"
	select TLS_TRANSPORT
	default n
	help
		MQTT need MBEDTLS Transport

config MQTT_DEMO_BROKER_URL
	string "URL of MQTT broker to use"
	default "test.mosquitto.org"
	help
		URL of the MQTT broker to use.

config MQTT_DEMO_BROKER_PORT
	string "Port of MQTT broker to connect to"
	default "1883" if !MQTT_MBEDTLS_SUPPORT
	default "8883" if MQTT_MBEDTLS_SUPPORT
	help
		Port of the MQTT broker to connect to.

config MQTT_DEMO_CLIENT_ID
	string "Identifier of MQTT client"
	default "uart-mqttc"
	help
		Client identifier to be advertised to the MQTT brokder.

config MQTT_DEMO_KEEP_ALIVE_INTERVAL
	int "MQTT Keep Alive Interval in seconds"
	default 60
	help
		MQTT keep-alive period.

config MQTT_DEMO_CONNACK_RECV_TIMEOUT_MS
	int "MQTT CONNACK Timeout in ms"
	default 1000
	help
		Timeout for receiving CONNACK after sending an MQTT CONNECT packet.
		Defined in milliseconds.

config MQTT_DEMO_NETWORK_BUFFER_SIZE
	int "MQTT transport buffer size"
	default 1500
	help
		Size of a MQTT packet buffer.

endmenu
```

## api/examples/test/peripherals/Kconfig
```kconfig
choice
	prompt "Peripherals Test"

config TEST_UART
	bool "UART sanity test"
	select WISE_API
	select USE_UART1
	select USE_UART2
	select API_UART
	select SUPPORT_DMA_DYNAMIC_ALLOC
	select DMA

config TEST_I2C
	bool "I2C sanity test"
	select WISE_API
	select USE_I2C0
	select USE_I2C1
	select API_I2C
	select SUPPORT_DMA_DYNAMIC_ALLOC
	select DMA
	select I2C

config TEST_SPI
	bool "SPI sanity test"
	select WISE_API
	select USE_SPI1
	select USE_SPI2
	select API_SPI
	select SUPPORT_DMA_DYNAMIC_ALLOC
	select DMA
	select SPI

endchoice
```

## api/examples/wifi/Kconfig
```kconfig
menu "Wi-Fi API Demo"

choice
    prompt "Type"

config WIFI_API_CLI_DEMO
    bool "Command-line Demo"

config WIFI_API_STA_DEMO
    bool "Wi-Fi Station API Demo"

config WIFI_API_SOFTAP_DEMO
    bool "Wi-Fi SoftAP API Demo"
	select API_SOFTAP

endchoice

endmenu
```
